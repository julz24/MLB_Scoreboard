// web_ui.h - page de configuration (style Material 3 : accueil Sports / Meteo / Parametres)
#pragma once
#include <pgmspace.h>

const char PAGE_HTML[] PROGMEM = R"HTML(
<!DOCTYPE html><html lang="fr"><head><meta charset="utf-8">
<meta name="viewport" content="width=device-width,initial-scale=1">
<title>Tableau d'affichage Sports</title>
<link href="https://fonts.googleapis.com/css2?family=Roboto:wght@400;500&display=swap" rel="stylesheet">
<style>
:root{--bg:#0f1114;--card:#1a1d21;--line:#30343a;--txt:#e3e5e8;--mut:#a7adb5;--pri:#9ecaff;
--tile:#0f4a80;--tileIc:#d4e8ff;--tonal:#2c3a4b;--err:#ffb4ab;--onErr:#690005;--field:#23272c}
*{box-sizing:border-box;font-family:Roboto,system-ui,sans-serif;-webkit-tap-highlight-color:transparent}
body{margin:0 auto;max-width:560px;padding:16px;background:var(--bg);color:var(--txt)}
header{display:flex;align-items:center;gap:6px;margin:4px 0 18px;min-height:44px}
h1{font-size:22px;font-weight:500;margin:0}
h2{font-size:20px;font-weight:500;margin:0 0 14px}
.back{width:44px;height:44px;border-radius:22px;border:none;background:transparent;color:var(--txt);
      font-size:26px;line-height:1;cursor:pointer;display:none;padding:0;margin-left:-8px}
.back:active{background:#ffffff14}
.view{display:none}.view.on{display:block}
.card{background:var(--card);border:1px solid var(--line);border-radius:24px;padding:18px 20px;margin-bottom:14px}
.nav{display:flex;align-items:center;gap:18px;cursor:pointer;padding:18px}
.nav:active{background:#22262b}
.ic{width:56px;height:56px;border-radius:16px;background:var(--tile);display:flex;align-items:center;justify-content:center;flex:none}
.ic svg{width:30px;height:30px}
.nt{font-size:19px;font-weight:500}
.ns{font-size:14px;color:var(--mut);margin-top:3px}
.chev{margin-left:auto;color:var(--mut);font-size:22px;padding-left:8px}
.sec{font-size:13px;font-weight:500;color:var(--pri);letter-spacing:.08em;margin-bottom:4px}
.row{display:flex;align-items:center;justify-content:space-between;gap:12px;margin:12px 0;min-height:32px}
.row>label:first-child{font-size:15px;color:var(--txt)}
.val{font-weight:500;color:var(--pri)}
.hint{font-size:13px;color:var(--mut)}
input[type=range]{width:100%;accent-color:var(--pri);margin:4px 0 2px}
select,input[type=text]{width:58%;font-size:15px;border-radius:12px;border:1px solid var(--line);
  padding:10px 12px;background:var(--field);color:var(--txt)}
.sw{display:inline-block;position:relative;width:52px;height:32px;flex:none}
.sw input{opacity:0;width:0;height:0}
.sl{position:absolute;inset:0;background:#2b2f34;border:2px solid #8a9199;border-radius:16px;transition:.2s;cursor:pointer}
.sl:before{content:"";position:absolute;width:16px;height:16px;left:6px;top:6px;background:#8a9199;border-radius:50%;transition:.2s}
.sw input:checked+.sl{background:var(--pri);border-color:var(--pri)}
.sw input:checked+.sl:before{transform:translateX(20px);width:24px;height:24px;left:2px;top:2px;background:#003258}
.kv{display:grid;grid-template-columns:auto 1fr;column-gap:24px;row-gap:12px;font-size:15px}
.kv .k{color:var(--mut)}
.pills{display:flex;flex-wrap:wrap;gap:10px;margin-top:20px}
.pill{border-radius:999px;padding:12px 22px;font-size:15px;font-weight:500;border:none;cursor:pointer;text-decoration:none;display:inline-block}
.p-ton{background:var(--tonal);color:var(--txt)}
.p-out{background:transparent;border:1px solid #8a9199;color:var(--pri)}
.p-err{background:var(--err);color:var(--onErr)}
.seg{display:flex;border:1px solid #8a9199;border-radius:999px;overflow:hidden}
.seg button{border:none;background:transparent;color:var(--txt);font-size:14px;font-weight:500;padding:8px 18px;cursor:pointer}
.seg button+button{border-left:1px solid #8a9199}
.seg button.on{background:var(--tonal);color:var(--pri)}
/* Logos des ligues : PNG 2x rendus depuis les SVG officiels, integres (aucun acces Internet requis) */
.lh{display:flex;align-items:center;gap:14px;margin-bottom:6px}
.lt{width:44px;height:44px;border-radius:12px;flex:none;background:#eef1f5 no-repeat center;background-size:contain;background-origin:content-box;padding:6px}
.lh .sec{font-size:18px;font-weight:500;color:var(--txt);letter-spacing:0;margin:0}
.lg-nhl{background-image:url(data:image/png;base64,iVBORw0KGgoAAAANSUhEUgAAADgAAABACAYAAABP97SyAAAaS0lEQVR42t1beVRT1/b+7k1uEiAhjIIMCioIyCwyOIFW22qdqnWq2larPqu2r1pbbfuelad9z9rWVquvWlvr1IoCCjjhgASZZEbCKDIaAgTCGKZM5/eHCaY4PGztW+v39lp35ZKcfc797tlnn/3tfWBh8LINgDmAu/j94gyAD6DjD/QxG8A8AKl4zlJGUdQdAH/9nfoOAG5RFJWku/898hGbzRYDKB2sAj3IdsEWlkPkyRl5Nc7OzksA/ACA9SzgWGz2+U3bv3AqKytzZhgm7hlBsgActxxiM/er70/UOTg4tAEIfJ4Al097ZS5VLW3sq6ysDF69evVoABcBmA5C15Gi6Zj1H4VbWQ6xdXRxcXHMzs42ZbPZsQDsBqEvBHA1cNLU4Zu27xnv7urM27BhIwGw7LkBpChqZtDkF4KLikqFMplMfuTIkclxcXFDOBzOVQBuT1ENYrOZmPUf7hDY2Dk4VZWXFKWkpJR4e3uPTE9P53M4nIsAxj5F343NZl99451NlnMWvxna2d7WLODQdiveeCOApumZz2vtzRrj7XNz748RxC9oQixN07Lc3Nx7hBAikUhknp5eIgAHALwCIEx3bQaQZT/MOXnr59/Kdh04TuYseSsdgAJAx6lTpzIJIaS2trbew8MjBUAGgA0G+rMBHHQe6SL64uDPsl0HjpO1H/y9BIB81arVIkmdlPj7B4gAvPQ8AJ7/196DxV//GEE4HG4BAAKga8eOHSlarZYolSpSVFzcMGfOPJGtrW2m62i3lPmLliZ9f/ys7PtT58muA8fJxGmvJOv0+q8vvvgihRBCtFotKSsrr1+7dm3SmDGeKba2tpkzZ88RRcZdkZ2Lv0UO/xpLxk99KUmvJxQK70jqpCQq+lwhgOg/Ci5AaGaWG3P1Ftn44WdFukFa9YOZm5vf2bPnq3RZk5w0NsnJvar7JLewjCSkZpPIy4lk/Qef3uHyjMW69j1Lli5LfG3h4kS9vrW1dU5KSmqJSqUinYpuImtuIZU1dSS/qJxcTEjuXPT6m8kcLrdY356iqFYAJCY2tkRSJyVCofAOAB/8AbdeduzUmfKYa8mEbyrMBkCmvPhK0vK330mnWawagxlR8Hi8qzZDhx7im5qeYbPZaQCa9b9zudy7Z6Njy4vL7pHS8goSGX2uhGGYagP9BoZhkoVCYYSNjc1hLpd703C2ORxOxZdffnV75apVNwEQ26FDMyR1UnLufEwxgJJBOqt+sQawiabpit1ffnU7u6CEzF/0ut5EWg+eiOw+eS6enI67TuYsWJzEMEzlQPMzeLB7CxcvSRSX3CUldyvInYJCRUFhsaKyupbU1ErIq/Pn3xwA9DcXj8e7u3nz5iRJnZRI6qSktKysHUA7APLR1q3Jkjop2bnz8zSKosoBvAvA6hEHqfv0BzATwAxra2ujZcuWdXy09eOxGgL+26tWJl2LvxwKAOs3bc0eP3lqAMOwwWbRYNgPPptkDXWFBflScX5+t1LZC1NTIV5btNje29t7FE3TYLNYSLx5PXfj+vXWAPDDkSPNL774kh9FPRg+Ozu77NTJkw29vb0wMuJh8uTJJuMCgxwcHBxsBz5wRETE7S0fbA4GgNVr1iTt2BEe2tbW1vHtt9/knT93zlQul/cAuALgMoBcCkCylZWV8rPPPjNesWLFGKFQKNBqtWhqbu6aNWtWdnZWVigAvPDyLNHb77wXxqJprF2xMMfM3KL34+3hdi4urs5sFgtsHViW7mKzWNCoVUi5lZy/a+cOVUNDwzjDB7W3t8/cuXMnN2zKVB8Oh/NMa+edd9bdvBAXNxUApk2bJvr+0OFgIyMjHgB0dnZ2RkdFFR048J2qoaGBogBsnTt3btD3Pxy1tLEyH5mVldm1YcOGppycHH8ARgAQNu1l0br3toQxDAt7dv49MSMtZYpuLK25pWW+i4trp+toN9rd3d3obmlpd052Nl1VVWHR1dU1ehARj5rPF5S5uLi0BIcEw9nJidvS0qLa+O57E/QN+vr6MG/unOTQKVPItq3bJgPA6rdXieLj48N0TRSBQUG5e778cvgQWzv6VnZh9d5dn0nvFt/JBgALmqYladli8t3PZ/ptHABhGKbi4/AvxGcvJpDz8SIy77Uloietl+d12dvbZxSXlLbp193NRFE1j8cr03viY8eO39H/dujwDzksFktioC//dM+htvB9RwlFUTWGkdaRdzd9mHI06jJxdnFPBEDGePkmRsTdIFGXbpLz8SISFDIx8U8Gp16+YoVI//CSOinZER6eqmMehu0U/9q9O92wna+vbxIA4ubtf3PXgePkxTkLUwAcMjQTL2Nj46KjkZfIOx+F3wVAGA6n/NwVEYm7nkxs7ezS/kxwNE3XR5w9W2j40IGBgUlP0/H18+v3riwWqxYA2bzjy9pdB44ThsMt1YeQ+lhU3N3d3VFWXFhkP8zJhcViKlRK5aiayvIyDsOGmdBMhT9JrK2t8+4UFHAnTpg4BgBqampqXUaNLM3MzJz8ND02i0UA4Pr16/kajcbRyNj4joXVEMeKsqJClbKvSU+pDIPt6JiIU00AMMLN4z4AJFyLr+dyGLw4Yyb7T8CmWbBggSg3L9/P3NzCHAAizkRkTBgfIuzp6XED0P005YULF3EB4PSvv7QCgKdfUCsA3Lh4rgXAucexiaiqijJ7APAJCDYGgLycLA7DsDHtxZecnicyiqKafj5+vHDf/u/C9HvhksWLk7Zs3hwEQBgcHCxau25d1tP6mDFzpgsAZGVlCQHAN2j8EACoq60aZhijGgKsViqVPb29vZ2j3D2dAKChvt6Ow2bD3s7eDkDP8wBnbm6en5uXj+nTpvsAQF1dXb3baNfilJTkUADt33zzbVZU9LkwLodDP+0FWVhYWAJAa2urOwAMH+Hq0dXZIddqNG0Aap/EB8tqK+5W8fmmQwB0aDSq4YAWDJsFHo9X+wexaWfMmCG6UyD2tba2tgaA2JiYvOCgQJ5CofCgKKpddOtW28JFi8Y9CLEo8qSOTE1NpQBQU1t7X7dXFxvzuJBU3asCUPQ0wltXX1fbqbuvBEA1yxrvs1ks8AWCzj9gkq2HDh3KPfLjT2E0/WDIN99YIdqwYb0fIcScy+VWEEKEbyxfLh1Mf0KhsBsAaqqqWnUD1Dja2aCjtakbgORpACWKzna13gwAoK2tVcFh2OCbCJS/B5xAIBBnZGb1zpo9JwAAGhoaZGM83PMTEhLCAOC9999P3rptWyMASCSS4YPp08jISAMAKrWK6ALqLgdba1AaFQFQ9zSALSql8oESRbcBgEqpUtE0DWNjnuZZwYVNmSIqLCr2srOzGwoAV65czhsXMJZub2/3BYATJ04WfPThR5NA+s3xieuOYZhaExOTEgBgs9kEABg2QwEATdMaRzsbGPEY7cCU5MAOzQWmQhoACNEaAYCFuYUxi0Wju7v7WbJo7fv3f5d96tQvYSwWC4QQrPvLWtGa1at9CCH9lMbH10eXWdNSA9gNCEj/vYeHR0pRcakln8/v0sWmNACYW1hwAYDFYpnb21jB0cGBBcDsN/vlgAezsrAcwtXdDwEAGxtrY5qm0dPTwwwGmYmJSfG1GwmC4cOGBQCAXC6XT50SViOXy8OepEMeRCe6Wz1SGgAUO8LDxatXr5kIABwORw0AXV1dbAAwMzMz1gG0AIChQ4eyAFg+bQZ9nUa52oOiegkhHgC67ezs7KgH7tjyP4ELDAxMEhcWeQwfNswRABITE8V+vj5quVzuz2KxpBFnI0tpmq5/jBOiBgL0H+snuJkokq9evSYEACoqKmobGhpsAUChUBgBgJ2dnSOAvt7eXhcAVcHBwZYAvJ4IkKbpEeZWQxzamxvyAfD5fH6lnq4olcphT8HWvXPnzvRz52NC9dxu0/ubRCuWL3PXarU2NjY2GeLCIpOJEya4GZrhwykkjzzPtGnTfV1dXYfrSG5O6ORJ5iqVykkoFIoTbt4cops58Hi8akKIsLy8vCI4ONiNoijPJwEMdhjuLAOAzOSbLQDg4+PT/CBayBQ/xpwBADwer/xmoki2ctXbIbqNt2Osv192ZOSZMADsceMCk3Jy84JMTU2FhrO0cuXKJEtLK4snmag+nHt96etJWz7YPBaAYPLkyUlFxSVednb2/Uzfzd29AQB+/PHHPgAYNmyYHIDn4wAuemnWqzwAEOdm2gHAosWLTQDgTMRZ+ePAeXt7pxQVl7i4uro6AUB6WlqRr4+3orGxMYBhmBrdywlNTUkp1OsYGxvLz0ZGFe3c9XnowzVIPQKwoaFBPsbDvfDWLVEogLZvvtmX+evpiFAA0Gg0yMjILAWAV+fPZ3SzbA3g3vr161UAXntkImiarjwadZn868BPSboUXbOejvD5fPEAutKzbdu2FEN688Ybb/TTGycnp9SS0jKF/u+NGzf2U5vyexVdhnqSOin5+/btKXraJKmTkmPHjol1+zAxMTEpSklNq9O3zcjMqhcKhQUCgUCs669bzxmbmpoSCCGEYZjCgTM4b1xgSA0IQW5KQhcAhIWFiQGgsbFRqlAoPA32o+r4q9ck+pRCZ2enIiQ46PaJEycmA0BISIgoJTVtvEAgMHm4tlmGm7QxIVAtfG1Bklwulxt4TAAgmze9f+utt97yJIRYBQYGJpXdLfdwcnKyA4ALF+Kyg4MCue3t7V6dnZ2e9fXSBiMjIyNfP788ANi7d696/89RaSNGe9QBmG4IcNmWrZ84cxim8MrFOCcA+GjrNkcA2PmPf/TXA4c7OaUXFhVbe3p6jgKAnOzsUs8xHq33798P7s8UBwQY7pd9AKBWa/odS21tbZ27m+vd9PT0UPTvdQ/2Qa1WO/Ts2bOTAXTt3Pl5+rnzMf0mufKtN0XvrFs3lhBiru9r37f7SgFg06ZNQgD46aefrMxM+Zjx6pLRAJbqARrxeLzhw51HDO9qk0kUCoU7l8e76+XlNVL31pwBKDe++25yampaiImJiQkAhO/4LGnu3DluGo3G8fGZSAAA98EMPlxboZMnqRQKxRjDRtnZ2X0GTutuYqKoeeWqlSG6tdjk7eVZeP369bCBnUdHR9kCwJQpL/jQNN0ok8n8hw210FjZ2A1nM4wnAIoGMGXcuHE1BAQ3LsUyADAlLKwOAESJN/MBsGJi4iq2bft4EgB0d3d3T5ww/vaRI0dCAfS8++57ya6jRz+p2tr3YGYePphGo+E+zJYplTNnvJx8+fLlKTqnlXqvotLVRbc9XL50KXdcwFiqvb3d83Gd9/T0uJWWlVZpiRaent5lAJAmuqEFAEtrGxkAXxpAwJQpU1QcDpOdlJRkBgBLliw115mMtqi4xDRgXIA7ABTcKSgf4+Euq66uDuZwOFXxV682bN22bVJkZKS7rm4wUB6ZQUOZOGF8V0FBwSQAvds+/jj58pX4CbpxsXbN2qS1a9f4GoZ2j5ND//6+RqPWYNbsWWwAiI2NpbkMU2g/zKkLgB8NwHXixIlcvrFRZ1NTkyMATJw0yQ0Apr4wzZ/P55sCwNdff5U8c+bLjiqVysnc3Dy/uKTUztPTyxkALC2tLD7++JMi3Z5NBluGVCqVIzkcTlV8fLxk48Z3JwFAc1OTzMfbK/fy5Yuhg6lfJiWJTNRaLSZOCrUHgOLiYgsrc2GLg9NIDQA3GgDfVChkGXO5jG4Bt/F4PJ6+g97e3p5p015I+mbv3kkAeLrN3Hf/d/szDQdav2HDRGtr65wncN1+CyWE9KexnZ1HpBaIC4d4enmPAoDr167l+/v7obW11X+wUX1HR4eZSqWGnYPDcACku7vb0sxMQEzNLFgArGgAHAFfwGaxaBYAxjDZU1JSWjXGw11SWlISOrBj0c2b2oHfxcZdsDE1FTzy1mmahdraGqnbaNcSQoglAKxbt/5WckrKBD6fb0IIwYb174hWrnzLR6vVDnkWSqZUKs3VGg3Uag0AtGi1WltTvgltKjSnAVjQANpkMplSQ7QaXVbbWq/80ovTuH19fS6PnRPtQzpz8sTJdF2Y5PDO+g1BjwCPjWHGh4SYKBQKTxaLdf98TFzJ3/7+t8kA0NTcLPfz9cmNjY0Ne2yc+p+zBSqVSg2VRgMAQoqi2pUqtba7q5MAUNAAGqpqqlVKpVrDMEwbAEahUHTqNvXuJ3f88GH27NltlJWVWaL7nhnoRWtqakIACO3t7TOLiorNxumcVpJIJB7r56tpbm72x+8UHs+oRaXRQN7S2gaAzTBMS3tnF2mWNWgA1NMA6qurqzV9fSoiEAhaH2S6pE26pGzzEzmcgTMhhOD1pUspw8XW29vbp/eiALB8xYqkjMysQL5AICCE4P2/vidatuz1Mc9qkgNl6FC7FpVKDcn9+026fE1rR6eC3dLUSAGQ0gBqbqelsbt7e80mTZrUBgCRUWclADBr9uy+J3dNaEM+19PT4/bhh1uSAUAsLrjn4e4m1VGw+sjIqKLdu78IBYDWlpZWP1+f3KioqLBnOMby5BMSc19llCo1Ll2IlepCzI62DoWVVFLLAVAFAEJTU9PsjPyS9ujo6Cxd7TxbUiclefn5sifVBjw9PfsDaDMzszzd991z5817WIO3sckSiwtb9e1+jYgo0BHe51XX6IiNT1BcTEgmfL4gHwCJij6XvuvAccIwnAIAQhpAe0dHR5+tlTB2/vz5fRRFyZqamsbWSSQN1tZDrEeNGpX6hMVNGdz3x9KxMTFhALBgwQJRXm5egLmFhRkAbNnygej1JUvctVqt7fPKkL8w/eUcisWYVN6rqFYoOn1ompY4jhyt7lJ0ylUqZRuAdr2JxH+9ZzcDwGjmzJnFALBx44YyADh56pdhemfx2zVIqMcFoDRNy37++Vj+vv3fhQFAZ0dHR8DYsVkRp0+HPYk0/x5hsVj31/11c5hKpcZX/wyXAMDixYsrssV3hemJV0sAXPjNcSsul1tMCCFisbif193OyJRK6qRk48aNj5SyvLy8bknqpOTNN99MMjhWkpuTmyfTm+TZyMiiAQXK53V1fbn/0L3ISwlkz3eHK/TfXxelJH595DRhs5lSADYDX8rXx44dyyCE3Jk9e7YIABEIBOKq6hoiqZOSmTNf+c3RjuFOTqmOjo7p+r9ffnnGb4qXy1esEAFQ/wng+t7bsi3zzIXr5OiZ2B6Gw7kLgCxbtuzGjxEXKl59cKJq52NLdTwer4g8kAQej1cOgPj6+vY7kxkzZjxS5aUoSn7w4MEsfRtxYXGbvb19xp9TLKVaPgn/153TcdfIiXNXiM1Qu1TdRBTE3UhJOvxrLOFwuLm6A3yPlTVr1qwREUJITk5Ogv5kkb+/f9J9SR2R1EnJ7t17buvTCQKBoCAzK1uqB3c+JubPMkliZmGReej4mcZfYq6So2fiiLXt0ExdmkMWc/na1ZPn48kIF9dbABb/p/V79tatW8Uajabr7NmzN/QDjBw5MvVeRaU+r9L9ySd/u2VokitXrkzUOaPnCozD4dxd997m1NNx18ip8/Hk4LEz7UIziyz9Wjxy9ER89BUReWP1+jQARwZVLzEyMkorLy+/39un7Pr3v/99WX/ygsPhVMZduFQ6MGm056uv0p/n/kbTdL29w7DULZ9szzlz8Tr5NfYqORF9mWz6ZMcdiqbrdG2avtz77eUronTy4afheRRFZerZzhPzCwZixzBMTPy1a/yx/gHuRcUl11+aPtVOl2pQjx49Omvfvv0Wnl5eow2VqqqrJN/t21eRnp7Oa2xstFEqlcMHEUATLpd7z8p6iNzL27dv/pKlI21t7R1Uag3UGg1UajXycrLEx3442COXNQYAoC0tLXNPnjmnMTIRjEtMuJ7/j79t7QUwA0DbYAECgAWAi59++im14b33gxXdvfX//Ed43vFjP40lhNjocpwlM2fObHzrrZX2vn5+Lg+ZhhZaLUFXd1dPWlp6+ZUrl1oTExKEra2t3gCIlZV13qSwsK7JoVMtx3h5e9IsNvSUR6X7LCkpunvpfFRDbma6vUqlGqnf+zZv/jBv6VsrA3v7lLbffPlFclTELz2EkAW6s6h4FoAAYALgiKe3t+Oxk6d9QLEE0gZZ057PwwuzM1Lte3t7XQ3attna2paHjB/fPXHiZH5QUJCjja3tELVGA41WC7Vag9Tk5AKtllABQcFeao0aao0WKrUa9VJpQ252tiQ3J0tRVJDHb5HLXQw9oZGRUcGC116ThH++27O3Vzns/v3axqWL5kta5fLbADY+lU4NMnBYR1H09r9seLdyweLlE1raO9DU2t5Tde9ealzkyfuVZcX2Go1mgu6FGNY6GhwdHasnhoYpFyxcNNLOztFeo9WgqqpKEn0mojI9LZXb2CB1JoQMZBRdbDY7dfr06fU7P/+nnb2D43SlSo22to7urR9uzrp65dJoQsgGw9MUfxQgdGcy32ez2fOmz5hTHzZjjo9KSwkN6nlZhdkZpTkZyar71RVmfT09DgBGGpazZs2eJ+pV9uLG1XjDUlozgEozM7P748dP7Fi2Yhl7/vwF7mq1OkCrm+Hq6urGL3bvLj1/LspGrVafBnAQgHxQhPh3hIF8AIsALDYRmFp4ePl3uYzxFo5wdR/BMzI2OIVPKQBtraS2uuZCxDFuXW31VMNOgoODEw4fPtzn7e3tDGAYIcREqyXQEoKW1taOmzcSKuOvxbdfiL0gaG2VNwD4FcAvz8z4/2DMawVgqu5/GEIYhmNp6zCs0dMvgOU9NsRVIDTrT3/cuHguWRQfOwkAwsPDk7dv3z5J/5tUKm08derUvejoaK1YLLbu6elpxoOD6pkAbgBo+d0HIJ7z6SVjACEAXAD4czg8fxt7B8WKdZt8jE34Zr8c2S8K9vfG0aNHw2QymXzu3LmFYrHYpKurKwtAPoByHbBu/D+SVUbGJnnbvz7ctevAcUIIIW1tbe1CoTAfwAr8j8hyE75pjh6gDtzc/8bA1H8R5HZr26HeHBZtVFdXFwfgMP4H5UcAn/03B/w/0S5xmd+4M5IAAAAASUVORK5CYII=)}
.lg-mlb{background-image:url(data:image/png;base64,iVBORw0KGgoAAAANSUhEUgAAAEAAAAAiCAYAAADvVd+PAAAFL0lEQVR42t2aeUzUVxDHP791F1YXlku5Sllli1XBKohSLFWqadGYVo1o44Vi1Y003kbbCh54BNNSbbRGURQTr1QrotEWJTa1lARFFKQqIBEPQG1LCnKtCL/+UV3dAoHdheUX57/5vt+bNzM7b97MeyvwnERRdAVWAKOBQF5PygXSgQRBEMoBhOfGTwcSgR7lj/+m6E4pYlNTl2qqtlcR4O9rhDXV1lN15aZ5AgUBpbc7Sm93gDogWhCEZEEURS2QX1lVo4xaFs/p85mS+bnOH0kgbPhgI+xKmI4nObfMlqns48mAPTGoh/k9BfwFURQPA1Mj5q8lNS1DUvHa09mBq2l7cXd1NmDV1wrJHjHPsuga5kdg+k6AQ4IoircBrUIz2urGDfDVANDY2MTv2fktfhc6dCC/HN9mhBUu/ZaypFSL1h9ZcQFB3q1AEEVRvPvgEW+9N80qhmu83Ni+YTFjRwUb4ZVVNRw+mc73ySkUFN83Gluum0L8VzoD/+yfarIGT6OhotJsPUJuHMPWyxXZ8yRoFeMDB/py6cyuZsYDOKhVLIgcT/6FZNYtjzIaS9j9g1Fukjva4ROns0gXsbERwHoOsFN1J3XfZpwd1W1+u3rRDL6LW2iEzVy0ibsPHhl4j8hx2Af2s1gvmbX2/KzJ4UbJrC2KnjWB0aFDDHxNbT0TP1uNXv/UgPXbsbJjHCAIQqc7ICwkwOQ5S+ZGGPHXb91h0ZrtBl7lr8VzzieWO8AaW8DJwc7kOcOD/Jph+46e5VBKuoH3WadDboZsq0bAmqWzGBky2Kxq0MnBvhmuW/UNfxSWGBKidlO0NCOgr48X2T8lErsk0mwZcnm3Zphe38CkubFU19RZnBA7LQLU9iomjnmf1LQM4rYeIG7rAerq9SbJ+O1SHlXVNS2OFd8tI2pZvMUJUd5ZYV/1pIYtO48YYZ/Pnkh3pW27ZSQePI1e39Dq+MmfM9i65xhL5002JMSyfaekeQzqZnyMi5PapDkfjghq85uVG3eRe6PY7IQot5YDVkZPNXlOZEQ4kRHhzfAn1bVk5xZw4HgaJ85eRKGQGxJi6P0zFK3YRmliSvu6ZFEUxZL7D/ENnd6pDhgR/A4D+/uwbf3CDpVbWVWDg1plhNWXlJM/M5bq3KJW5717/ShKjYf1tsDFrDySjpztcLn/Nx5A2dsD7YYFKFwcpJMDAMaHh1ptLaewIQxIipVGDnBxUpOStJGQIX5WvXNQuDhKIwK6wngAu0G+DEpNwMajp/kO6OXiiPcbbmYrMXvKmC4x3rAVPggiOOcgrpNGmV4Kn9q/mbKcHynOPEzGyR2YfhErELM4kq6mbqru+KydDy1UvK1GgFbjaXRzExzQv8XurK2jT+PlhhRI2dsDn/Xz298LtITJBNNSRtjwAKRE3kum4TQysH1b4HZJKed+vWzgs67eJOPydZMW9H+7D1IjWQ9l82OwtW5wXOQXuLs6Y6NQcK/0kcmLaXt7Ssr42qJ7VJzLau4Amaz1dvjh4wrzqzR7lWSMF581UrDwa8Nt8IuEKAOKvTx6GRqKjiQbhUISxuvL/iR/egyVmXkvdXNzBiiUA5dlMpl2zqdj2X3wdIcu/ObQycB/r0DlV09Yp+dw+4imOn2bZbLM1gYgRwbEAk83rZrHhDGdU6v/VVFJzJa9kogGdbAf/XZ9CdAAxL94Hp8N7AforOdxGxuFVSrCysy8l/v81WNdJkOp8cDWy/UFFCUIQrLwyh8kgoAEoC/gzutJ5cAtYJkgCNcA/gWVU6PoQSQsYgAAAABJRU5ErkJggg==)}
.lg-nfl{background-image:url(data:image/png;base64,iVBORw0KGgoAAAANSUhEUgAAAC4AAAA+CAYAAABUbymsAAAMWElEQVR42tWaeVxUV7LHv1dQoNkRRAU3VERwGSEqxn2Jy6A+zaBGHWfIxJhxTTJxohNjYnRkzEfzPmryjOPjRZ8Yt6i4JbiQiETFBRRQ3EAUQRCQpRuaHWr+AC627C4zev7qe6pO1a/r1qmqW+fACxoi4iUiFrxqQ0R2i8i8Vw20j1QMnYg4vyqgbUQk/dcr8ZKRnSsi8vOrANpERM6mZ+VK10mfyeSPNlcaXv7xMoM2F5GT+QVF0mvaKlG85oriNVfmr9ldBX7589TX7DmBbg9E5hcWj5q0+J9cjU9RaZt+OM0XW34EWCkie0XE5LkAF5HxIhIqIqtERPMUVl4F3HiQntNt8OyvOHn+Rg2+L7b8yOxVOwCmALEiMv0pjOMoIv9bibWLIiLvAltycvOxsdQkAx8qirKvASHWwFzgL4DDjp8uMv/L3eTqC+tV7u7ShsCVfvRxawcQCXylKMquRoBeBizLyM4zc7C1AOijiMi7Obn5WzymrGL7yj8ysp8bwAMgFIgGkoGHgADOQH/gHcAs4OBZ/L87xr2UzCZZb8KQXnw4YwTDXnOt0rW18o/kAMaVepyBAcAgwOrbfWFs3vcr0buXqcDfy8nN32w3fDEA7Vvb8dtBHvx+XH96uzphblbtkpk5em4lprEj+ALfB19q0MLdO7VmZD83Ojvbc+CXKNo52rLz2CWV3tnZgbcnDmDMAHfcO7XBzLS5Skt9pCXyxn22HQnn54u30OYV0LV9K24dWAHgqYjIe9m6/M0tRyx+bju+t6szX388DScHay5cu8fWI+EsmDqUCUN64TDqr2Tm6J9KbmdnB+IOfgHgWWdUaWljztPQ/uw7mCs7PyEzJ49biWncSkyjoLCYCUN6ATDMy9WA397G4qn01Al8w+KpdS766oPf1Tr/t7fHsGnpdB6k5+DibM/3wZeIT8ogLOAjladru1bq774eHZg5rl+detZ/NKVOmvHjDyYtjFkwdRhd2jkwY2xf4u6nk5iaxbYj4QDM8umPi5M9fxjvTUlpOfHJ6Xyz5zT6giLe8O7O6vn/BcC2I+Fcu5PCoreG0+UxoAAtmhvRoY0dfhMGMLB3Z5wdbbCxNOPnizc5E3UHjWkLFr41DBcne2aO60d8Ugb3UjL5/6Pn67Z4UXEph8NiGO3dHYDBfboQdCpKpR8MjaafR0cAxg304EjYVfQFRQD894e+APT/45ekZGhZs3AyeflFVIYvdej0hSSmZnHlVhKj+rvh1rE1zY2NOBN1B4D8wmKOhF3FZ1BPAAb27kxQaFTDrhJ3P52S0jIOn44hLVOHNq9ApeXqC0nL0nEoNJqi4hKuJ6QCMKq/Gx6d2xBy4SaBK/1w7dCKtdtP8kalAR4ft++nA3A1PoWUDC1no+5wJznDgOd6QipFxSUcPh3Dw0wdurzC+l0FoLW9FVOXBhAT94AxA9xrLNh9PIIT52/Qq6sTbR2sScnQ4t2zEwDZuflM+1sA86cO5Zsl02r1zfCYBADsrDT0nv53MnP0jOjbzYCnrYM1kxf/k5i4B+rbbxD4w0c6Hj7SAXA8/HqNBScqU3pM3AN1rkfnturalX+ewIyxfWtV9n3wRbJ1+QBE3rivzv9y6ZYBX0qGlpQMrYG+RkeVN0f8hsbSmhsbVfzR89eZP3UotlY1Sx5dXiGL1x8wmLOx1NSwdmMx1ArcqZVNveFw7ftv4uJsrz7rC4pJSH6Ed49Oda6Zs/p70jJ1BnOTh/fmrTGv1crfvrUd6+oIuzWAm7QwZtPS6ST95I9TKxvKIzbx/vQRKn2u7xDKIzbRycme+IMrCVzlh7mZCZnaPI6euYrfBO9aLT11aQB7T0aqcx3a2HFx+xL+77NZzJ40kIcnvmRwny4AaExbELjKj3tH/07Hti0pj9jEoreG1w+8qLiUeWt2qaFpXeBJNuz6RaV/uy+MVQE/AXDlZhKzlm9DX1BEeMxdCotKcHa0VXnzC4tZu/0knSZ+yr6QywZKE1OzGP7eevV51mfb+PVKvLpu1vJtXLmZBMCabcfZuPtUw65ibWFGclo2njP9cbC1rLGgrb0NfWb4c/1uKjaWFb4cfC4WczMT0jJ1nItOYNHavbQZs5QlG4PUzfjkGNjbhWX/c4hxC7/Bs6LMNfD9uKR0PGf642hnVev6GkWWmWlzCgpLGlX0NIX3yWHSwpii4tImya23yGoKkKcFXeWWzyK3RhxfPOsNfAb1eKk+xNdsO14jp9QA3q2DI0O9ur5UwJ8ssGoFrtYsbm6UJCWpzw7LluHwyScVNA8PSu7dM+Bvt3MneSEhZH/3XYNA3PX6WmVYTZ6M844dz7c9oTt06KV6C3UCtxg71nAzXbumWshi5EjDlN+hAy1cXNB4e2PUsmWjFFuMGmUY3kxM0Lz++rMDb7N+PbZz5hha/eDBCtrGjZg/ptgpIACTnj2xnjkTx9Wrq8Oalxfuej3uej02b79tKH/DBgPj2P7pT9jNm/diOlm6oKCmNnGq/Xf8+PqZy8ubJNu4KcwFERGUpqVh7OjYZJ+0GDsWd73+P9c7bKrV/+2b83lHl6zNm8kOCKibQVFenKsA5IeFUZbZuJZbaUoKGatXU5KaSs7WrZj07Int7NnPxeL1Alces4KJhwdFsbEVH81HjzYO+MOHZPj7N3YnvxhXsZo0qdpdDh9+uX388XBmZGuLxejRAOQdO0a5Tteg8BaurnQMDm5cGm/W7MX5uLWvL3knTlSExosXG+Q3srREM2QIAC7h4VBa2ig9xXFxlKamYuTggEn37s8YVUSwmDgRjI2fKgGZ9uqFqadnoxJQ2qefcm/cODIey8LPFA6NLC2xHDPmhftv8d27zz+OW/n6vnjg8fFP7+PaPXvIO368+rUXVvTvLH18UExMkKKiBoUrTdhwUlZGXnAwukOHqmXXs74ZUFLViQIoKS0DIMPfn5LExGq/W74c7c6dNDM3x9LH57nE5ipjAGQHBHDf15ecwMAa6/MLi9UWddVLaQakWGhMcGxZ0QYIjbyt1tg13sL+/RXRZcqUZ3aH9M8/Rx8aWi9Pc+eKawCnIip6ix6VPUog2RgIA3LfHP4by2/3hbH3ZCTTRnsx+fBhSpKT0YeEkHfqFHkhIdWV3ujRNDM3p7yWaq8sK6tB0GXZ2Txat65my6JHD8yHDMF8+HDMBw6kmbU176wMJCM7D4ApozwBTimKoq0KW+sSkjPE7PVF6lH2d4fOyZOjODFR/Z368ccSq9FIrEYj+rNnRUQkbcUKdS5Wo5Hbrq5Snp9fQ05ZdrbEajQS16ePpLz/vmj375fSR48MeLK0enlnZaCKx933CyktLRMR+e2TJ8RJQaeixHTAQpXZdfLnsv3oealrFN+9K+n+/lIYGysiIikLFhgAj9VoJGnGjFrXlqSm1jqfpdXL0q+DxGLQByqOjuOXye3ENBGRY+rGfwy8K/Dz9YRU598v30rUrWSDzunIft3o2cWJHp3b4tW9fa2t5ILISLI2b0a3f78aGYxsbemWnFyn29x/mMXlm0nExD3g8s37nDh/g8Ki6obQLJ/+fP3XaVhZmIYDYxVF0RkArwTfGggCvP+x9Tgbdv1CelZurQrbtbZlqGdXpo/py7iBHoZJUK9HFxSEdtcuCqOjDYDr8go5cOoKP4RcJjzmLjm5tfcWX3PvwOdzfKqaU9sURTH4aFVqSdNGwBJgBdB878lIgs/Gci4mgbjK85snRys7S957czALpg2rcVhVlp6OUatWxMQ94KsdIQT+eKFO6/f16MBQT1f8Jnjj7tIGIAuYqSjKsRo5op46ww4YBUwChgFtsrR6Lly7x5VbSUTfTubXqHj12KWqt73Ubwyfzh5X/eWj1bNw7V52PXYUDhXH5f17dKJXVyc83drRz6MjpibNAWKAU0AwcFpRlFrP3ZUmFEwdgcFAP6Av0BswPRedwPYfz7PlwBmVt1+Pjvyw5l2uxj/Ab8V2HuXkGfyxaaO96Nq+FVRcOrgMRADngFA11DWUlXm2CzYTgVmAb+SN+7yzMlA91HJxtich+ZHKO/UNLzYsnoJjS6scYAewR1GUM/yHrzV1E5HgkpIyWbIxSA1jitdc0by+SPaciKiKdutExBZevntZH4hIyY6fLkiz1+aJ9ZAPJfJGoohItogMgpf7JtwcEZFFa/fI7uMRIiKZItINXo27h9/m6gur3GMwvFq3PS+JyHp49e7W9hURyxcl/1+HDjyceNrqXgAAAABJRU5ErkJggg==)}
.lg-nba{background-image:url(data:image/png;base64,iVBORw0KGgoAAAANSUhEUgAAAEAAAAAmCAYAAAB0xJ2ZAAAJG0lEQVR42t1aa3BU5Rl+3u/s5h4gG3LbDZSLlCQIKNWx1gFDYEZuY22rjKUdythSS3X8QRGipXVrpzXR2nEUe1GmHXphHBk6TRmhKCQBaXGmIEwbSdASkrghCZuGkAths3u+tz822T3n23M2Z0N++f06t/2+8z7f+z7v875nAQDM/DlmbmDmAZ54RJj5Y2Z+Ap+B4WJmbyisn3n+9eMz6+qbMTAcit1Mc2s49KvNKJ+Tj+4330L7rlqASMtZdvuCea/59zBzFhG9ZJywuPKFOW4hLiesxNz2aUP13PHT0qpaPwHPxW/T+kDDzsPRezUnCLQicQqOANRE4NOSxRudjTvP2xk2a2XtNRBmJMwB2hqo37l3/FwAeHF7zTsz/3jovMl4APjCIh/K5xUAQqD48U0QmRkAM4bO/gcfrduC0fbOnzGzzxHURHNQ4U+LnTL0VHeLiFxEuANE24Tgc76VNZstH6z0u6yMjyIgvcZTEdHl6ndOXrR8dvODd8aORy62Qo7cjJ3r/YPoO9LoBrDcqQElRemLx48lWL9V9yXQb7wrXp6lXi+VWXPtfwMzAH3XR4qkZMuHz7d0xY4HTp1JuD8a6AYAn9MX1pjK4x5AehLDyJlHIFNo4R8l3BC6LwlqJgBcds/dUVaCuxZF57nR9DHadvz8lgmHiCpix4J1wNpOBjMZ7jHjOAinwJxJhMcBmm6YdYXFQl7bl+AkAAhB+MkTq/Do+qVId2tx92+5BJGRbgqByQwmxDxAstAFsUPk+FigvroGAHxVLzQL0O8N9xbgkbc1HNho8ChK5pXmEDCePLnpXnzroWUm4wEg/+G1WPqvOmQtXniLPsBxDyAZmVQISO288qzwdHRnK4D57B2AigGmBAAK8rLx1DfvtV03rbQYZQd/DS03+1aCYP54JkjGAYnpLw4ISengd/YeQASadd+LJQkAbFyzGGnKzqvDXZgPz4OrU9tz8A0DA2vFRRkLoiGgZAGSjKkbyYnZHQ+DGABbvrLM0czpc2clx164WUGgw5QJSFREnxNmAFjQ1NmfXJvopACwdvnnUZSfY/uDa0dO4JMtO6KsOWNairnaDACN8QBNgQ6wpVqF6QHuMVMEl5iywNfXLU0WgGh/phYcjnJW5sJ5KYYA2sm0eDQTSGZdEE25+UVf+kUBEbkU4rtAQJGBB8weMGNahu2Eg6fPIdTWidHOHkT6+pG9uAyU5k4l+fcBCMX3Z8wDUiDBVIbmiviU/WMwWu10ggCA7z9fhz37P7CO+dleiJwsAED/sX9Am5GLgk1fTsEFOAvMTYbVK/DI21oqIUDEHOcYLYEs3dNDsblIU0QQ8RUQeu04QgBAoGcAj65dYpv+8tbcDwC48srvAGZ4NlTZ2yvDql9nM9EFYyYo7Wmbx4JDdlmAwWw/v67OH+p59+lhg7TxKZQQJImgnRoUADB/lgcz87JsjZqx6r4xRdiKobNNqQqiDGZuMdmqyQopMTjJAv425UqrmWSlT8n7QQnVA+IAuMbiJOmYdv89gBAor3sDOXdFC7olH/wF/e+dskmDujELuAAyASBBFQRqsE2DTGwqE5hWl1bVZoDZQ4BaAh9NJoKYOUgkgoDRSJqJSr8Ljf6ICwAud/ahKziIkoJca91Q4EH+19Zg2vK7Y9cyy+YjfbbXSRbQIkJrcRtCnogrIsDfhE0xRGSW6ERYBWCVqpAZ0MMR8apaDSuz9ZLUg9CESQ16RzO8V4AOMe4Bew+esSchtwszH16bWHVmZU7IAQRyd3tmXzS6BTHKxah9CPCEPhnzrq09J5++rFxTQoCDo+zqTbQpSpYxWP5Qdw4jN8P2OxlOrF30/gEnHuDCgY06mD8xvOXiG+70ATsSdNoPYMbrxStrFiVTgVIiKMVw0MLLzACERiPY/ep76OyxNupGyyX0vnUodn69/p/o/u1+R6l5bEUDD1BauozkJTFMKnH8Jku5ksHrwGgyNkRcwLPmVhjlKT2IYLDRPwTwqFVjxBRrB442oWbvCWs9UFqMS9/bjQ8XrMS52x9Ay1e3QR8cdsTbY27fbOIVwQuZMWJFgioHgNAaaHymMVBffUSCq5WtXB0P/vQ5CTstKThWUV41ywMLAACgrr4Z759tS7BieuUXAQDhYN94K8y5NgcgyQwAkawAWfNAMg4gXa0tUBgrsUViJ0inSHDM4qBVKhRWi1T/8ihuhswx7y4uQOFjGyctUYUuWxR9XkFsDYDKAcZ+gNXw5HoyLEUQANKiIohYEUOUBIBPu6/jsd0HEdGlucje/u3JNEEYAG5SqFm5XM6YpBiybxclAiDFU6VVtX6Qkh4ZJbYAAMCpD9uxvfZwgix2lxSmWA5H3TnY6B9iRsDwAktAPDC1DZHEThAR/Tj6ASbekDVmC5Fsur8ev4BnX3kX4UjcEzIXGlruKfYwCHFJTEQ5BMqZ4l6AL4UqNQ+VfpeY6Lk/HTqPDdv2oad3KFrZLCkzJVMnpZxBEzRP+oWd9R5Smq9QS58tnDzY3BrE+m37ENElfD/YGleATgQbG0pZJRMwU+FUAkAWnSBmnGDGCQb+nZCfpVYinE5+tW8YHV390KbnIq24wLkHmIogvqh2aK10gJoGjf0AywzjGuFoBWUmOsl0MNCwqzLQsKsSrH83MSSlT6RiwMkzbYCu42Zrx6R2KBSWzQ6/+dkjq9EC9VKvd+4Nq1YYEWLiZ1RQ0OoLUkoA7PnzabDQYh0iZ3EZ54De93/YxcxDDjS+VLTU6tKqWn9pVe1rAO9TRFMnDmzUXWnstSDdGACsh65ahUxKAASvDaMrOIjce+4cZ3KH3GQaHzn46JlQDhPwHAFPEimZg+nvY2nUZ0E/MaODjf4hMNRqzys80zN7hMN0xgxEdIncu5eM9QnyAaAztQ+kaJ4q0mPGiE7aT21VoNSumrHiLlUNCpcmjm2oLHOeOjzZyKy4DZTmhuehB8IATk5Azay89JQBAPB3uup3tFu1wgBAF6wWQAm9QQFg18s71/V8Y8NSZGemTbjkfzv+B31wGIuO7kOar7CaiK6klgnM7bHUGyI8CvAhMK8JNFTvT6YCXWGpeACuWvYGmTmfmV9i5isO/iQVZubDzFyJz8D4P8TCxmF32JRvAAAAAElFTkSuQmCC)}
.lg-ncaa{background-image:url(data:image/png;base64,iVBORw0KGgoAAAANSUhEUgAAAFgAAABYCAYAAABxlTA0AAAakklEQVR4Xu1dCZRU1Zn+7r3v1aut6eqmodkEAggkqCCRxKgxiNlN4jEJTMyZEBeWaDJRJ4nj6CiYyWTiJGfimEmMgJJkMpqA2yQxOh4VBkMcJYtjBGRfZBGBppfa33v3zvnvfa+6urq6u4AGF/o7p6jq4tV99/73/7/7//9dHsPJxooVAuuHMNx+kdfl1st3pOBiMgSfCOVPhlJTwPlYSNkAIAkgCsABmAJTBYClAbQB6jAU2wvGtoGxzRDsRfDIK5g7PNOl/EWrLGCmxO1Mnswms5NyM6UYVoJjDvNL91u+IwrFpsOXFwB4P5g6G4yPhO0A3AKUBKRvXkqZv+mdwDjAGMAFwOlz8KJrizkJpV4F5y8D7HlIPIP69DrMOaOof1uqC6TurBOMEyvgaoK9b9sMIDIb8C+DsCcgEjNCdAuARzJQEgoKjOrGjEB0LUmi5VB0FV2ioEhQij4zMM5hRaBf1AHFHOB7rwB8JVBciavG/6VUygolcIIFfeIErCsfaOyPdjXAwefA2FxAnYtYEijm6aXAmK+FCHCwSiEeM0iLqWwFpQQiUaY7MtvuQ4hn4Ps/Q+u+h/C183L6DuV17Wf0v4AXKV7iuXv+UA+n+VoodS2c+Cj4HlDIkKqR3Qd2fTJA/KIpwUI0YSilkN0Ewe4Ca/kp5k7L6E5eDNbfHN2PAlYMK0o8y7B85zwwcTOcxFgUMoBbJP5lYNS6Nwyk0WaQi0SF5vtCbjOUdzuuesf9+nsaDG+f6fcXP/ePgLto7ZbzEIl+F07sPE0DboG8BdGP5t9PIK5XCpGY0HxdzD0Oz70J88e/ZARdZonHgeMXsO7xizz822YHdc43wfjXYEUE8mk/GKjeSI2tAcGgGq8TKBZzUN4d+N///jaWLHT7g5uPT8Dh4LBs89kQsSWIJs5BptWYIWOihta9eaCUD84FEikg27EWhY4rcc2ULSUFOkYcm4DLB4Rl266C5dwFYSWQz3hgzDrGurzxIMoAfMTqLHiFwygW5mPBhEeOx507egEvWmRM/vbbJe7d9R3EEn+HXJp8Wf8tp7U9gbTZsgWEDeQzN2HBhDt0BDp7NlnmUQUnRydgEi4JljyGe3ctR6L+i8i0epDyTTiIHS/I22BAIsWRab0T88bdoAe+xRQE1S7k2s3ZRFQKy6+IQu76BRL1l6KjxVBCv8UHbyYwrimDFCjZcD2Wba/DPDbP+O86hKxJk2vT4JBzp4ChY+cjSDR8EukWF4D9ZhLJCYNSHuoGW+hovQ/zx16tOXk2aqKLGlwoinBWCx3htO/4CRKpU0u4BLJSUqi61FVYsuVOnQJYjZq8pL4FvIqEe5GHJVu/jWTDXyN95NTR3K6wkW7xUNd4HZZsvR4XMc+kQHtH7xQRBhH3bP48kg3/iVzaAxT1XG3U8nYDcbKwyMOwkMt+HAsnPK69izlzOtOwFehZUGGouGTLFNjR5wEZg+dRLuHUFG4JSsKKMEjVAtedjoXjXsWinpNE1SmCBrUpKxmWqyiE+DksOwHPI/fkFBeuJmQOtyDhxAZDsOXam6DBvwerri5gPfswx4e77dtINExDPk3uWE2kfkqAcYFsu4dEahbu2XqdHvRWkPvWHd01MuSUe199Lyz+e7hFmi2gHw9obzmIjy2LcttZCHkW5o7ZWY0qKqXOsH620kKWxX8HF9zkqgeE2w1El56r4MSTKHh3GqpY2U0Ju34RZseWbpuHRGopMq1vn/zCiYKi5FCC0rOfwLzxj1WmODsFbObFgHtfSQLRDbDskfCIHmrwlU9t+HBiHLnMS1CtM7Dv177J1xh0UgRFa3qSMLIAifpRKObpor4DkQEI5LMSifqpYI2XaeGWBSAmEjGJHB/ffTEB4DoUsgp8wCWrHYzStQrwv4FF6kFgcYUGk/YSSaeSc5CoP037eXrqdQA1gUHo2fJo8hyM2TVTazGNZ50UsNrkeIEFkJ5ewTGAowWTsGzAl9eaX67U/7LSqHffzulgfB18l1bUDEj4qEELXUhpVQ6efCcWjt9N6QaOIYG6+moOokmu3Y4BHAMYg/J9xAfFIdhluoCZtHLuIvhYpSww+Sm4edLpAe49VtCKOt+jWfVP6yJWQwa+7/ap4Naf9dKmAQI+dlD4zAVpcg6WfTquGL3XaKtUsxBLkrAH6OF4QOEzza7H62NwPVqWG9IBuxDypK5LfvuCgjW9XlldZAT8Mwou1DS9Pncgcjt+KMX1OmelppPry+EOngDGRpnFzwMDXD+AaVkyNh7LdzZz+N67YEctqAGO6BcQD5OzwEUDfDWRg8l3QdCeCL2aYgD9AiVhR2mZzmRi4wkmqT4QvPUb9B4TvVFnPC0DGmuWYQX54AH0A2jzDqV35GjygxuMizagwf0GUla99QzDKB9cH+xBozUPNd3D0pPU1a+VSkFWYXNO29p6Kl8pUA6vEuFtzHvfdfNluLOL7lVTUzSovtUGIGE2kvU5ONE1epdNeSFmT1+9BQZL/3EUFfIoXdzTkGgz6JpV/D9lQaXXSzDj6EyUbnDYGR4JzFU9S6ASEa4dTeXT1rijCJxs4svuHeKH964FVGlqOzWBchJEEZwl+lxb1Q1Kqfln1qshUcEphx8qFmmuzRn+a1dWrj9U4MyixS9GWCTcs4c68uOnxbkrq0yWKOX/eFOH25pH1OKA50tIV8KKckwZ6mBSvY1RCQsOhflVGkv6YXGlVmzP5re0FGPD6oS6cFhCry/tS29IJE/vy/mH8tKitoS/UVKp80ZG5WkJS1A7eipHT1oyYE/Gc9fuzwsmGNfKa3amJi2zZy1Qnl5qowXlA2MHWd6SC5p6zLi9b2hEfuI3+xm3Lc1DHAzS89U3zqz3Lh+fjFTIR7en4CN91/p2wTmHl3cxusHGl945CJeNTWByquYVsvlHd2YL8BC7amJd8Z/OaXRqUTyy7EuePJD+7Y5situdZh7hTD48a6hqjtemg384WMjNeGhPjFmca6LSLWPkAMOthXuJP6XnY9aIpC8By/UVBIm5pFJ6Tys+NDLBJzQ5cusRT1DpnlJwYsI/b6jDyeTLZ1I9xTSbPLC9w8tmvCSZ6t9Mq1eL393IGp3OPiRLKVW6AlIxxZliG4+4hfWHi1FYSs0cHmW+UqCKil7ImMq1OFjSgjCcaYYh6SpMHe7I5rgl+prfIcsl2UQEYhDMkiERG2V1KcGeq2X6TctRSfWxUTHt4ZFgyKYsHr6MGUU4+MJJdQqebxrnKUxrcviYOtuivyOl6xnJk9kc/qM7s+CciwcuHqruOq9JC5cotDT40G5kSlSX/Ta8LwmXPq85kPdQ9J0hSVu9pzkeEYzKNx3Y00tzPcCGxKwY3YzqrwdiX+GDI2L6TxJ8b2XQfej/620uBNe7SWlANn4wkCULbjdOcc+Dpc5jSiCZjBQ+PCpG64N9KrgSJADCF06vY4MSghSehlf1ydPiLQAO+hKlIwxIYahiBV/mV7+Wtx68ZDg+Nz7JiKOpM4mLqTj6LLjuUMkB2ltM9y8huKf35J4cA7PY+cOcjnoLB+he3baPV1bYjPSsjlhIKaWzjcS3FvMvH5+gexWrlVFtHIhbrBixuM6Y6VrTKQBQHfTvAfNHzzAFkp0q64O/3o9b1h1J6wmSijtRKfRdc0yIz45PSlnwlRUV7O6N7dkpD726f0+mqDNK1IhAjnhiTz7/9TMGOZeNjoGES1oXdJ2OLzngbmlzN970QusfL33swMsPbO94zZNQRV+SUyKlhMp6svDswYKNmIW1+/LujEf3HWgrerozwxMQehvwEoLnwlwB1c2KcHX9moPbfrktvZ8Uyaf9/wG0y1gmqvBz3GJIkP9q+izU4ANkArs18egjAXpH1oe1bk8+OcjRe+GY2VZWHV+eXMe4TZdI7M2w0a0eP6uZTDFwoQM5KnI2rj+j3tENK+NLX1GqD4W71rdtmPjAqw13/Ll1xq92ZWcMjtqnEW9GBOcWB73Y+iNF90i7G40IiYNp2fSp8fVnNUatKPFwqIEkiHa3uutW7wjam6wbQobsu8r6XYucdvaQ6Jigvlo41FyqZ7q8nEDCMVvYjQ53QqrRN2ZsN/nBW/r0pANoc42L4qVjErrYauMHmT1VYnpTlJ8/Iuo/uzfPmV9Ul4yqL8Qs7tCgp/0homcJecEwZ1DS5l1cKtqKLxiTd21o237dqkOnW/XROFwXdhT517Pupt+8KpWUkpGPEhPMW7qpPcVtkSrmfZw7KurfemaCkTeoB+bAldzS5mLJpg587z2NJfcxREOE26GgiHL8god7Zjb5EwdZgiyS2hS+3/FSG6YPjuDDI2Ol77SrBvA6i3v6+ISwMKm2WmB8I3x9EEZ1bzuAcdMUxqZsf3K9rX2nniIzsig6/OEr7xyEZ1/N6VVvHxoe7bb1wOIQ9REhys1XCxdg61uL+6/7n0MjrTon7hcKmiA9VzlfePLApG7BlWARYQs6b0YtvaBJD05Bo/UcGJnbl587XDLn0O7C6LDR4TFqDFFcseBj1tiEvOL0upJwqZNIyJvbXNz2/GE8+YkR1cxWxiyWA5jNSJYuyZRv5CjmN8J1OyC039qjzWthehIXDXPIziwyvxCVoWY4AH5qdJyPqo9IYXN54fCo1noRNLP8Rl04zQzmhS+tPcyYZQ1SvmtGH2OrTMTsqBW3Y+FLxO2Y7VjCz3u49ZwGdUZDRAdAodYRLT64I4OnNndgEEVsXWBqkbAY8TV5kYjZTN19flNnwBH0Jr1/ae0huHnZLVwI29JALpIevS0G301DFTZyvDZ5Nxh2wI706kkYKPmRUXHd1PKuIO2uJH6qbdTi/PLxcUxI2X5zLIiIggurxTT6lA4GvHyk2PG7PdlGYnrfCLwEX0od6YUvSlS5BR9nD4/KG89qYCRcbW3B++s5H1/9/WFN1vlgVK68d9zmRSaYpBTAbTMa5cR6W3cSlRN21g82tGPVrixYhCNbEYYHri8fFid3T0pG51Ao7EDqpd3h6STr9JkJtPynCqhCVGY0Zrnvb9ZJAxN4BFJ++UixJef5+fKf0v9Tz35hQhLXTKrT6bpwoCBkXJnL+9rt6hzpjXKoh3ak6aCZqIk5e4YWVBAmL3v/EO1X694vC0yve/4w9ne4ejQNBVyJlM2hKJwfFlFfPyNVsgA98DJga7uHW55vga2DHwVKxXQ1BOM61Ec4saPUygqso20YwbQ91hgFrZ4T1oMZBQyDI15z3LI1v5Xlc258oYWvea3QRt+HLk2o1Wc2OuLL76rTYavOAQX+9v+1FNMFX5O/XhMTvGusP+IKxfVa2l4FTIGLn5e46d2NcnqTiRTLB6Sfb03jFxs6dDSjPFka/UMNDh3CqEAkEuHsR+c16cgu7CRCwVe4cs3rSGd97cRTR4QaXFm7Otu4e4HGaJmaQNtna5BpL4KLiPFuu7rXmgJ9X314ZFw7EpQWpMYR1xZ9eGv25+tiFst/ZFScDuHotlnGCiOQslnVJ/bm1NRGM1hqb6rMbqMWHR3Ve6JGB4lFiTOGO/IfptYbrQvcmtC7ObMxgt99eqTpCKlQR9m2skxreE9fwV707gZ5bjOF2EYRdF0DivjWOY2IvMfYBQVck4L8SHhdiCaHU7hpIdfuQvFAwLQf7hq2E8u2rYOTPB+5NBlqFyFpixDwPzTS0IOO13UIyfBSS97PFGXk8d3ZREvBb290RAPlkcpdktBLCN7ZwYLCb3Zn+a1TG3RUFmiw8asZYxcOi8X+4y9tyo7aTFVLLpsjqojR1JILmuAIrgXTqZkGUxsrc0tdEV4/KmGxm6eltOdRKTQKID4wjM7E646STgQfhsVFFE6cFvb8CQvG7yBG4LRAzfxUrdSTnxUhM/2WsmhDkrY3vTFS4l+TsAee2Z+X8BXLFWTivk0dmoel7Eo1YUVCWf3pUEG9+HqB5Xwq2SSrdR9y47d+blzCumBMHIUOD35Rdn+5Cm7aVddPTan3DY1ySshUCkaXS0uiy1499FUY4FRN6WvaqyinkhrC9jU43IMQEII9rCuwmiS6Omifzx5Bpv2fwUS0nCa0mbgS5zfH/LgtIqEJ0SBGivzU3ry2JWZZ/EebOqyvn5XKWJzRSvly99Z0odFQPLU3q1TWTbzS5h6cMcRppBkrfYCfVmeAAo8nPjocP1zfptYcKLAOjzJWpgx6IzNtchi+Ob2BAoqScMOgIkQQz9SEciurrHmtsyMOxUv5dCYatx/Wg8tqSEvvotd748bvxtKtv0U89Rm9yS7gZ8O/nvrYaZp/OQmJPCe6aVvB9144VOCUjaFwYcchd9Aze3NHZo2MJcjroIRNOQwXQj21L6cQiUS/91JrccXFzbTTJhLIvuQBJGyOG6c1sBt7Fk8Xb4t+X6sgqqELvVTzIXtBcLlyIlYcAr9qnzt6a7gVOcgmzw7UQ/0QnvuZcgrV/qAjvA80O/pak80z/LvuUNFrS3sOjwpat6KYEM73N7R7s0bGKAsV6RKhBZq2pb2oXj5cYCJmYeWWzPBHxmX2XfaOxBidDAhmO3RqRJulGf2qtTeM1ILsotbi+zZ3+D94sU0Ih+l6lzRZp8osluTyyJMfaxYxSwyqHCdCv3dv2pVznj6IvCSa7+rHaA+lqDB3cvLwDWemGnyzljKEGjXI4mPq7R/vAjB7ChitcTcCpq2gdFzM1RNWY+m2FxBLzkA+43POBE33TBoc8SalInrEIGowJ8wBT+7NUQ0E+auUY2C2wOM708nXsoOPDItbzeUmG7b36b05mtPjdsyHcqz4Z596vem+DzTt/eLEuiZwVhpNSHA6Z9EHiL+pkbs6XPnVtQdZJl9Nlek7CmN8mfUUi1WZpKChh4Gp659vkc/tzlogn7c72SqanhidKmRvOBMNJAS6hLwCykUMYVi9c/ZpT9L6NEaefNe1aDMpfUDL4O8Ik6zawn2Jj4yI02iv+Z46kQJBAPkn9mQp2x6QOG1mlvBd1P9gQzsdLVvkTLuOdG34G++xPTlJhKtTltKDsnjyiqcPDv3o4/vbn9qbO3I472fD39Tyzk353rW/PywzecXtqAC3WZeXsDmj6SAuWDTjl8bUEshSSHEe2ZGWD23uEDZNcVhdy6AybSrXEWgv6uHyiAA6GNBuMbTq5DrHtxjTwVqlgxGAtHjKYoa27S8gmpjO8llt2SMSIt9o/HitU+RW0ci9qbUYDxOfnfbIEIHMT0xFXD0lV4HN7W7MJfMrg+DczOD6vlcXFy65TYIbo+hNgYOARxV9xTe3ujGmg5NeoJQanbBk1KZjWTsR8v/utKsKnok/qpVjzoLlLC5k63uHRHcopSzKQSGasFIq/9wjH2xeWHliYFdjmTKFabpYuuMWMPa4Ca+AfRk/uq+jYm02Nb3aqKIUioxHXz7kVnceq+zZp/yCXh5nC6vDg7VRHwd0FCCXmGacew/8tI+9O+0LqK5nQ5cQuEY9QbvaSiLr89Sq/f7ZpajNzgGHWs3uoor9yt01JNxtv3Tro0ikLqX9yozxajNEPfqVgZZXRU++aIjeftsb+io3RG+eRujb1wAljI7TkQY2S7f8RM4//UpZ5Zjc7nNFtNuechKWuB6FbDud7qFoXiLI5pe/99LTXa6r5Tch9KBR5V59fVcreiunLwMog5m1tiLCz6UPedK+WVJEvH5xtyK6C5j8YjqQ48p37EQxf5Pe2jWwd6M7GPcRiXG43nVYOHa/PvWkbBN4yWKq9rw5wUNg4cS7kW75FRIpWl7VA3GdgiBZkEwyrSuwcPz9evN3+fn05areo3jCMypHLGiE7f0Rwh6NYlbqM9JPZdBOACdB+zA2wfXei33jOno7brFnYZG6k1excOQhFNzPA8qFsImfj4Kq3nYw+5GVn0c+fTkWjm/DhpW00qRHmfSujXQwEqn/NRPWIp+eDycuwDkdan/qCVkfus8lLIejmLsC1075s6bRlT2fmUbo29zp1L9FysLCST9Ftu02zT06DDyVhKyTIj4S9RZy6Rsx//Rfapn0wLvl6FvAhNthNHn+hH9ER8udSDYEqzJPASGbHKuvFav90L9gwYTvmhMR9Ux0n+g7m9LpoXY+ZWDZ9n9FInWDPjSJNt7Vsvz8rYiQFpIpgfSR72DeuL8Pjn+gfENNNFmbBmswpY90pUhv3ri/Rbb1NkSTwmx+fhvusaM2UcoiGhdoP3Jrp3B1sqgm4WqpHYNi0SEe5rlE926fCxFZAsYdFHNv7fPby0F+boSSmtKFV5yHq8f97Gg1N8RRaHAnV5j88SpL39jNXwzf36k5imLzt7KHoeuuPCRTFqS/HYXMxbqNnYFEzZp7PAI20N6FHvjWon3PuShkHkS8zoKwGaSZzHxLgepMSWBSlHzmYbTnzsWCSc++MY95KEd5BunenVeD8zvgxAcj20ZPWqHDq47FSk4e6IkDlAGOpzgKmUOQ6hZcPWaJrkA/PETqWDi4O8yKIIpoJO7eMRZR6zuwrL/SFJ/PvBmeYVStzqZesSRtiKfplfuRab8ZX5my61ieNtAT+kfAIcp7fNnOS2Dxf4AdPVfvJM2nSZ3NovU3yq0z44OpA53womdWvdXwvG9h3tin+0try9G/AiboJNFimMeG0fM2ds+G4F8FE+frRXH5DDUq5OgTL+xOoUI/fMSJm2fZKayC8r+Pq8b8Wteb/Hm9hbDvlf5Hg/4XcEmbK842X77nYij/CgAfRzTRqLXaPK2QTng1iy1oxdXxareJvGii10wcCMsIlWYT85mDAHsM0luOeeM6FzyuXGkOpD4BOHEC7kIbZc/PXLZrBBguBWOfBuQMOIl67dD7rnnkpKcnsM1jJ/VkW7gMq7yqZd5S+eMmabsUPR6HLIXeyZnJZ1sB+Sw4fxgi8lvMHf56oLHdnzN6AnDiBVyu0bTApTxBcv9rzSgU3wfFZkGpaVDe6QCGwYnRLGaQTwoelho8Z68UG5n5bXPEpl5xLekph6Spr+un09IDU4X1LBh/riTU0DOgYw9PkMZW4uQJOITm6Jn06v4I3p/uGQzXnQjFpoCriVBqOJQaArDBgNJL6806D0aH4rhQKg0m94Pb++BjO5h8CZHoti4C1UINHjW8eKaho5OI/we43SkefRQndAAAAABJRU5ErkJggg==)}
.lg-pwhl{background-image:url(data:image/png;base64,iVBORw0KGgoAAAANSUhEUgAAAEAAAAAoCAYAAABOzvzpAAAIb0lEQVR42r1Zb3BU1RX/nfveA4pJqDDVKaUDzoTaYQTzxzp16ifbSpUv/SDiTGdspWPttEMku5uEQEIWBALJ7oIRtHSGanFqx3YUFW0pdIYZZ5jqlN38kdZGU4mMzgS0cUjAhLz37umH3WzuLrlv70uM99vuO+++c37nz/2dc6nWTpwE0Q9RYjHjE4AezniREzqZGjvRSET7ci/8j5l+lvGjr2MWq9pJ/FIw9oNoQXZbbsp4sQ6dfJWVvF8QP0tEN5XcnHFSMKHZRBEifI2I/1qFjiqdzLB3pQvMQ7kXlpDA8Son8Z2ZGn+7k7pTgJ6ZNB7MQ8PelS6tA5xErSXwhpHxAOCJZpFxY2lmHDNVyrLFU7png4iPg2hngTwjNVMAbJbJIi/sHER8XOskxgHTvZn55TTqMwIAfA9bmFnCLBTurrETa3WP0+7oYYDPq/LVdvL7YY2vtVP3guhuReXz2b116Zf6UaF8oPHS96gZAAQA9CL6HhGeN1WOiDr1T+OSJVoL5IG9od1PnChQWqIViEu9Ttxhvjcd7UX0vTwAAOC5YhsYruEWq2us5Abdw4wf+wPA/Ur9uKPWSvzY2PtWcj2A1Yr5/dk9NYXSSj1UKB9Y+FzfpZbJn3kAehH5mBmHjUEU3A7EhfY7kmIFfwjsBZhK7xwXELyvcC9uCJIXQu6BefL/pheRj68DAABcf2I7mMcNIbilxil/VB8F0deZcVaRv7XGSv2k5LFnVTwC0C3K8Xs24zcc10aLU/6YKl8i969O+G5boV+U9Q6aP2OYV21i7KhE13zdcwmxuShPA6MGiNuCZDxoD3VVoms+GG0hCsuBd9D8mRYAABjx5u0D82Wz/XBzue1qFezx6s8w44SCwLKsxzTet8vrQLRM8f6JHq/+jE6+wp6IgnCzYehfHvGc6wrldQAMoG5EgtpNMRXg5kp0VWi5hicbiopQ23RRU4vDCwWwLfDdQu9XENBonPrAngHUjZQEAABGPecAGBcNj5RFi+wJLZvsQ8M5Bl5Uo6bCnnj8unSxR5tAWDylMP+pDw3nArzfAqJFhtZfHPHmPTm9A6dZA6i7BuKdIU7tzWvQqaWf0hVbwPAVXrBVjZrVaL+RgKiisC9dq0m33xp03kTAJvPUx44B1F0zBiDL6GJPA7hgGAULHIt2aGsB6geZ+Ehh1Lj5Y9KxnRgR3ZC3n/hID+oHtRTZoSfy/UHpdSHtRp/Rp3BQ5MjCnCwBwqNV2L9CWwtcblWPWAZHVqP9xlyBekspVuOey63abg/7VxDTz41zX/LW4BoWsDJ+pIDRlQgzSzhyb0AtuMSggwqdvsGxnbbsdxqOM9Cbe3SoDw2X9M2Y3wmCZWh+f8aPvjBjAABiX4om81TDhjXovE333PUm9jDz1Sl5+tXtSH0j5/kmZr464bm7A3L/NhA9YKqPlNQIEM8CAKDHj7wK5reNW1ibtE1JloQoRyzBsZ0s8cl4sb8R84ZiolK4tzgQgvK+3e1HXyt9jBssH1Y0RKd4X5W9/3va517ZfjCGFbKzcbJ2pP2GN/QkKfUDIhi31aY6GwGQZXT8d3NyJLWeSuOxz0HYoQAmhOPvK7kncSqE908FMcjQAGRZGdebR0Fw+5t2R58G80dKLXgwqHZUW4kHjNtdAK7HEXNnGa4+NJxj5pdhvnNA+xv3mKnVrHbEhRDoMHc+XgpikDMGIBsGVkuIzuvWWiv5cPG/KxBfkGuXn2Pwv0vVjlqrbKNpu5utMdwSxqRQAGRQ/y7Avw9BQXcBcVv9a7Fd9kqeNkvRElQ7KtE1H0S7QjQ8z6UR+8+cAZDl9SH6b6JlVVbFOuXeYC0RrbUtsT1HtI6pQxMi3FFtJe7LNzzWxDrjdhcAuVZbWHtCA9CN2IdgdBmKf9DjR15Vwrw9O07Dr6vQsTJHnhoLR21TA9Rh/8pf8vcMpac9T6ax+cKcA5CtsnK3GRPj/HSnxup8EEB1/sO29QsASHvR0+oRS6A1OVkMIj7OJinA+Jy9ebtnYsuMAOhDwyUw7yqRj73dfux55SDfVXQr87upwlXU+iqyGTd6qHRXyqlu1H3ypQGQIwYJZtbSVlK8X20lNxJopfL4aLagTpKj+gwzXlKiYGW1ldyocPqdAUgPw/MSMzVjxgCkseUy9Bce3Wk/9ooyDH2iMIes1mnu6VqLBqj5d7r9yBGA/zu9/XJvTpcvF4DrLkMLtYpOja0TjxPRUmXGcHC6YpVB/bsMflYpmEtrncTU6ExmT46iyjc07F19ajY2zAqAQcTHpcLrc9X4n2kvehoAVuFQGVi5JmOMse9ow3nCpbYiIFtX4VBZtlGKvKDMDHKTI4oHXZaaLAuzXEPy5Nml4l5m0JsMnPA9bryIU1cBYJl9TyMRrVNUTmZkvbZFvYSTI18Xa79KhO/mwmChJdyxIXnyTQBYIu8/JgR/CuAMgU9nvFhqtvoT5mitQmrxV2w5CKLyybk8PG95qXz9Ng4uWWhfGyRCWe690QnPXR40J5hzACrRVVFmX6sxvzESFYKwDYQ7lXDemvaiRvcNNXYyTjTFOJn5H2Bul4RRUx3GPJnuR1NJedtks0WYPwZyjwL45oxgZQxf9hzzKzevrAP2lU2T9wREdBeIXrPMW8KP+jG2/AtNgRqr8xESU+QlzGLQpowbOTg13em8i4H5hdxHjGfc6FtTMsmIICRn8j0p8dNuP3r0C68BNU7yfQIqwxmPgYwbXamOtgTxKY3wPZMnSO4I/SBMK5wbt7+fcWPfmpNjkCVvD+d6/lS6/vqCD7Is03qOUV4E3np1fmjkUUnbMFc8oNuP/RHAvwy8PsgSB8c8uboHjT0FhM+nD7XK+HS+gBy5sbTn0RoG/9bklorBfWk/+ucwNv0f8HiQxZ33aLIAAAAASUVORK5CYII=)}
#logsBox{display:none;background:#0a0b0d;color:#8fe08f;font-size:11px;line-height:1.4;padding:10px;border-radius:12px;
  max-height:300px;overflow-y:auto;white-space:pre-wrap;word-break:break-all;margin:14px 0 0}
</style></head><body>

<header>
  <button class="back" id="backBtn" onclick="go('')" aria-label="Retour">&#8249;</button>
  <h1 id="hdr">Tableau d'affichage Sports</h1>
</header>

<!-- ===================== ACCUEIL ===================== -->
<div class="view" id="v_home">
  <div class="card nav" onclick="go('sports')">
    <div class="ic"><svg viewBox="0 0 24 24" fill="none" stroke="#d4e8ff" stroke-width="1.8" stroke-linejoin="round">
      <circle cx="12" cy="12" r="9.2"/>
      <path d="M12 8.2l3.6 2.6-1.4 4.2H9.8l-1.4-4.2z" fill="#d4e8ff"/>
      <path d="M12 8.2V2.8M15.6 10.8l5.1-1.6M14.2 15l3.2 4.4M9.8 15l-3.2 4.4M8.4 10.8L3.3 9.2"/></svg></div>
    <div><div class="nt" id="t_navSports">Sports</div><div class="ns" id="t_navSub">NHL · MLB · NFL · NBA · NCAA · PWHL</div></div>
    <div class="chev">&#8250;</div>
  </div>
  <div class="card nav" onclick="go('meteo')">
    <div class="ic"><svg viewBox="0 0 24 24" fill="#d4e8ff" stroke="#d4e8ff" stroke-width="2" stroke-linecap="round">
      <circle cx="12" cy="12" r="4.6" stroke="none"/>
      <path d="M12 2.5v2M12 19.5v2M2.5 12h2M19.5 12h2M5.3 5.3l1.4 1.4M17.3 17.3l1.4 1.4M5.3 18.7l1.4-1.4M17.3 6.7l1.4-1.4"/></svg></div>
    <div><div class="nt" id="t_navWx">Météo</div><div class="ns" id="t_navWxSub">Horloge, emplacement</div></div>
    <div class="chev">&#8250;</div>
  </div>
  <div class="card nav" onclick="go('param')">
    <div class="ic"><svg viewBox="0 0 24 24" fill="#d4e8ff"><path d="M19.14 12.94c.04-.3.06-.61.06-.94 0-.32-.02-.64-.07-.94l2.03-1.58a.49.49 0 0 0 .12-.61l-1.92-3.32a.488.488 0 0 0-.59-.22l-2.39.96c-.5-.38-1.03-.7-1.62-.94l-.36-2.54a.484.484 0 0 0-.48-.41h-3.84c-.24 0-.43.17-.47.41l-.36 2.54c-.59.24-1.13.57-1.62.94l-2.39-.96c-.22-.08-.47 0-.59.22L2.74 8.87c-.12.21-.08.47.12.61l2.03 1.58c-.05.3-.09.63-.09.94s.02.64.07.94l-2.03 1.58a.49.49 0 0 0-.12.61l1.92 3.32c.12.22.37.29.59.22l2.39-.96c.5.38 1.03.7 1.62.94l.36 2.54c.05.24.24.41.48.41h3.84c.24 0 .44-.17.47-.41l.36-2.54c.59-.24 1.13-.56 1.62-.94l2.39.96c.22.08.47 0 .59-.22l1.92-3.32c.12-.22.07-.47-.12-.61l-2.01-1.58zM12 15.6c-1.98 0-3.6-1.62-3.6-3.6s1.62-3.6 3.6-3.6 3.6 1.62 3.6 3.6-1.62 3.6-3.6 3.6z"/></svg></div>
    <div><div class="nt" id="t_navParam">Paramètres</div><div class="ns" id="t_navParamSub">Affichage, langue, système</div></div>
    <div class="chev">&#8250;</div>
  </div>
</div>

<!-- ===================== SPORTS ===================== -->
<div class="view" id="v_sports">
<div class="card">
  <div class="lh"><span class="lt lg-nhl" role="img" aria-label="NHL"></span><div class="sec" id="t_secNhl">NHL</div></div>
  <div class="row"><label id="t_spNhl">NHL</label>
    <label class="sw"><input type="checkbox" id="spNhl" onchange="set('spNhl',this.checked?1:0)"><span class="sl"></span></label>
  </div>
  <div class="row"><label id="t_favNhl">Équipe favorite</label>
    <select id="favNhl" onchange="set('favNhl',this.value)"></select>
  </div>
  <div class="row"><label id="t_wcNhl">Course aux séries</label>
    <label class="sw"><input type="checkbox" id="wcNhl" onchange="set('wcNhl',this.checked?1:0)"><span class="sl"></span></label>
  </div>
  <div class="row"><label id="t_altLogoNhl">Logo alternatif</label>
    <label class="sw"><input type="checkbox" id="altLogoNhl" onchange="set('altLogoNhl',this.checked?1:0)"><span class="sl"></span></label>
  </div>
  <div class="row"><label id="t_wideNhl">Affichage avec chronomètre</label>
    <label class="sw"><input type="checkbox" id="wideNhl" onchange="set('wideNhl',this.checked?1:0)"><span class="sl"></span></label>
  </div>
  <div class="row"><label id="t_liveNhl">Matchs en direct seulement</label>
    <label class="sw"><input type="checkbox" id="liveNhl" onchange="set('liveNhl',this.checked?1:0)"><span class="sl"></span></label>
  </div>
  <div class="row"><label id="t_standNhl">Afficher classement</label>
    <label class="sw"><input type="checkbox" id="showStNhl" onchange="set('showStNhl',this.checked?1:0)"><span class="sl"></span></label>
  </div>
</div>

<div class="card">
  <div class="sec" id="t_secAnim">Animations et indicateurs</div>
  <div class="row"><label id="t_goalAnim">Animation de but / touché (favori)</label>
    <label class="sw"><input type="checkbox" id="goalAnim" onchange="set('goalAnim',this.checked?1:0)"><span class="sl"></span></label>
  </div>
  <div class="row"><label id="t_situation">Indicateurs AN/PP (LNH) et possession (NFL)</label>
    <label class="sw"><input type="checkbox" id="situation" onchange="set('situation',this.checked?1:0)"><span class="sl"></span></label>
  </div>
  <div class="row"><label id="t_testAnim">Tester l'animation</label>
    <span><button class="pill p-ton" id="t_testNhl" onclick="set('testGoal',0)">LNH</button>
    <button class="pill p-ton" id="t_testNfl" onclick="set('testGoal',1)">NFL</button></span>
  </div>
</div>

<div class="card">
  <div class="lh"><span class="lt lg-mlb" role="img" aria-label="MLB"></span><div class="sec" id="t_secMlb">MLB</div></div>
  <div class="row"><label id="t_spMlb">MLB</label>
    <label class="sw"><input type="checkbox" id="spMlb" onchange="set('spMlb',this.checked?1:0)"><span class="sl"></span></label>
  </div>
  <div class="row"><label id="t_fav">Équipe favorite</label>
    <select id="fav" onchange="set('fav',this.value)"></select>
  </div>
  <div class="row"><label id="t_wildcard">Classement meilleur 2e</label>
    <label class="sw"><input type="checkbox" id="wildcard" onchange="set('wildcard',this.checked?1:0)"><span class="sl"></span></label>
  </div>
  <div class="row"><label id="t_liveMlb">Matchs en direct seulement</label>
    <label class="sw"><input type="checkbox" id="liveMlb" onchange="set('liveMlb',this.checked?1:0)"><span class="sl"></span></label>
  </div>
  <div class="row"><label id="t_standMlb">Afficher classement</label>
    <label class="sw"><input type="checkbox" id="showStMlb" onchange="set('showStMlb',this.checked?1:0)"><span class="sl"></span></label>
  </div>
</div>

<div class="card">
  <div class="lh"><span class="lt lg-nfl" role="img" aria-label="NFL"></span><div class="sec" id="t_secNfl">NFL</div></div>
  <div class="row"><label id="t_spNfl">NFL</label>
    <label class="sw"><input type="checkbox" id="spNfl" onchange="set('spNfl',this.checked?1:0)"><span class="sl"></span></label>
  </div>
  <div class="row"><label id="t_favNfl">Équipe favorite</label>
    <select id="favNfl" onchange="set('favNfl',this.value)"></select>
  </div>
  <div class="row"><label id="t_liveNfl">Matchs en direct seulement</label>
    <label class="sw"><input type="checkbox" id="liveNfl" onchange="set('liveNfl',this.checked?1:0)"><span class="sl"></span></label>
  </div>
  <div class="row"><label id="t_standNfl">Afficher classement</label>
    <label class="sw"><input type="checkbox" id="showStNfl" onchange="set('showStNfl',this.checked?1:0)"><span class="sl"></span></label>
  </div>
</div>

<div class="card">
  <div class="lh"><span class="lt lg-nba" role="img" aria-label="NBA"></span><div class="sec" id="t_secNba">NBA</div></div>
  <div class="row"><label id="t_spNba">NBA</label>
    <label class="sw"><input type="checkbox" id="spNba" onchange="set('spNba',this.checked?1:0)"><span class="sl"></span></label>
  </div>
  <div class="row"><label id="t_favNba">Équipe favorite</label>
    <select id="favNba" onchange="set('favNba',this.value)"></select>
  </div>
  <div class="row"><label id="t_liveNba">Matchs en direct seulement</label>
    <label class="sw"><input type="checkbox" id="liveNba" onchange="set('liveNba',this.checked?1:0)"><span class="sl"></span></label>
  </div>
  <div class="row"><label id="t_showStNba">Afficher classement</label>
    <label class="sw"><input type="checkbox" id="showStNba" onchange="set('showStNba',this.checked?1:0)"><span class="sl"></span></label>
  </div>
</div>

<div class="card">
  <div class="lh"><span class="lt lg-ncaa" role="img" aria-label="NCAA"></span><div class="sec" id="t_secNcaa">NCAA Football</div></div>
  <div class="row"><label id="t_spNcaa">NCAA</label>
    <label class="sw"><input type="checkbox" id="spNcaa" onchange="set('spNcaa',this.checked?1:0)"><span class="sl"></span></label>
  </div>
  <div class="row"><label id="t_liveNcaa">Matchs en direct seulement</label>
    <label class="sw"><input type="checkbox" id="liveNcaa" onchange="set('liveNcaa',this.checked?1:0)"><span class="sl"></span></label>
  </div>
  <div class="row" style="margin-top:10px"><label id="t_cfAcc" style="font-weight:600">ACC</label>
    <label class="sw"><input type="checkbox" id="cfAcc" onchange="set('cfAcc',this.checked?1:0)"><span class="sl"></span></label>
  </div>
  <div class="row"><label id="t_favNc0">Équipe favorite</label>
    <select id="favNc0" onchange="set('favNc0',this.value)"></select>
  </div>
  <div class="row" style="margin-top:10px"><label id="t_cfB12" style="font-weight:600">Big 12</label>
    <label class="sw"><input type="checkbox" id="cfB12" onchange="set('cfB12',this.checked?1:0)"><span class="sl"></span></label>
  </div>
  <div class="row"><label id="t_favNc1">Équipe favorite</label>
    <select id="favNc1" onchange="set('favNc1',this.value)"></select>
  </div>
  <div class="row" style="margin-top:10px"><label id="t_cfB10" style="font-weight:600">Big Ten</label>
    <label class="sw"><input type="checkbox" id="cfB10" onchange="set('cfB10',this.checked?1:0)"><span class="sl"></span></label>
  </div>
  <div class="row"><label id="t_favNc2">Équipe favorite</label>
    <select id="favNc2" onchange="set('favNc2',this.value)"></select>
  </div>
  <div class="row" style="margin-top:10px"><label id="t_cfSec" style="font-weight:600">SEC</label>
    <label class="sw"><input type="checkbox" id="cfSec" onchange="set('cfSec',this.checked?1:0)"><span class="sl"></span></label>
  </div>
  <div class="row"><label id="t_favNc3">Équipe favorite</label>
    <select id="favNc3" onchange="set('favNc3',this.value)"></select>
  </div>
  <div class="row" style="margin-top:10px"><label id="t_cfP12" style="font-weight:600">Pac-12</label>
    <label class="sw"><input type="checkbox" id="cfP12" onchange="set('cfP12',this.checked?1:0)"><span class="sl"></span></label>
  </div>
  <div class="row"><label id="t_favNc4">Équipe favorite</label>
    <select id="favNc4" onchange="set('favNc4',this.value)"></select>
  </div>
  <div class="row" style="margin-top:10px"><label id="t_secTop25" style="font-weight:600">Top 25</label>
    <label class="sw"><input type="checkbox" id="showStNcaa" onchange="set('showStNcaa',this.checked?1:0)"><span class="sl"></span></label>
  </div>
  <div class="row"><label id="t_showStNcaaSub" style="color:var(--mut,#999)">Afficher le Top 6 dans la rotation</label></div>
  <div class="row"><label id="t_rkCfp">Classement CFP (sinon AP)</label>
    <label class="sw"><input type="checkbox" id="rkCfp" onchange="set('rkCfp',this.checked?1:0)"><span class="sl"></span></label>
  </div>
  <div class="row"><label id="t_favNc5">Équipe favorite</label>
    <select id="favNc5" onchange="set('favNc5',this.value)"></select>
  </div>
</div>

<div class="card">
  <div class="lh"><span class="lt lg-pwhl" role="img" aria-label="PWHL"></span><div class="sec" id="t_secPwhl">PWHL</div></div>
  <div class="row"><label id="t_spPwhl">PWHL</label>
    <label class="sw"><input type="checkbox" id="spPwhl" onchange="set('spPwhl',this.checked?1:0)"><span class="sl"></span></label>
  </div>
  <div class="row"><label id="t_favPwhl">Équipe favorite</label>
    <select id="favPwhl" onchange="set('favPwhl',this.value)"></select>
  </div>
  <div class="row"><label id="t_livePwhl">Matchs en direct seulement</label>
    <label class="sw"><input type="checkbox" id="livePwhl" onchange="set('livePwhl',this.checked?1:0)"><span class="sl"></span></label>
  </div>
</div>

</div>

<!-- ===================== METEO ===================== -->
<div class="view" id="v_meteo">
<div class="card">
  <div class="row"><label id="t_wx">Afficher Horloge et Météo</label>
    <label class="sw"><input type="checkbox" id="wxforce" onchange="set('wxforce',this.checked?1:0)"><span class="sl"></span></label>
  </div>
  <div class="row"><label id="t_wxcity">Ville de la météo</label>
    <input type="text" id="wxCity" maxlength="39" onchange="setCity()"></div>
  <div class="hint" id="wxinfo"></div>
</div>
</div>

<!-- ===================== PARAMETRES ===================== -->
<div class="view" id="v_param">
<div class="card">
  <div class="row"><label id="t_bright">Luminosité</label><span class="val" id="bv">-</span></div>
  <input type="range" id="bright" min="0" max="100" oninput="bv.textContent=this.value+'%'"
         onchange="set('bright',Math.max(5,Math.round(this.value/100*255)))">
  <div class="row" style="margin-top:18px"><label id="t_speed">Vitesse de rotation</label><span class="val" id="sv">-</span></div>
  <input type="range" id="speed" min="3" max="30" oninput="sv.textContent=this.value+' s'"
         onchange="set('speed',this.value)">
  <div class="row" style="margin-top:18px"><label id="t_screen">Écran allumé</label>
    <label class="sw"><input type="checkbox" id="screen" onchange="set('screen',this.checked?1:0)"><span class="sl"></span></label>
  </div>
  <div class="row"><label id="t_lang">Langue</label>
    <div class="seg"><button id="langFR" onclick="setLang(0)">FR</button><button id="langEN" onclick="setLang(1)">EN</button></div>
  </div>
</div>

<div class="card">
  <h2 id="t_sys">Système</h2>
  <div class="kv">
    <div class="k" id="t_ip">Adresse IP</div><div id="sysIp">-</div>
    <div class="k" id="t_net">Réseau</div><div id="sysNet">-</div>
    <div class="k" id="t_fw">Version</div><div id="sysFw">-</div>
  </div>
  <div class="pills" id="fwPills" style="margin-top:12px">
    <button class="pill p-ton" id="fwCheckBtn" onclick="fwDo('check')">Vérifier les mises à jour</button>
    <button class="pill p-ton" id="fwInstBtn" style="display:none" onclick="fwInstall()">Installer</button>
  </div>
  <div class="pills">
    <a class="pill p-ton" href="/update" id="t_ota">Mise à jour OTA</a>
    <button class="pill p-ton" id="logsBtn" onclick="toggleLogs()">Voir les logs</button>
    <button class="pill p-out" id="t_wifi" onclick="wifiConfirm()">Reconfigurer le WiFi</button>
    <button class="pill p-err" id="t_reboot" onclick="rebootConfirm()">Redémarrer</button>
  </div>
  <pre id="logsBox"></pre>
</div>
</div>

<script>
const TEAMS={108:"Angels",109:"D-backs",110:"Orioles",111:"Red Sox",112:"Cubs",113:"Reds",
114:"Guardians",115:"Rockies",116:"Tigers",117:"Astros",118:"Royals",119:"Dodgers",
120:"Nationals",121:"Mets",133:"Athletics",134:"Pirates",135:"Padres",136:"Mariners",
137:"Giants",138:"Cardinals",139:"Rays",140:"Rangers",141:"Blue Jays",142:"Twins",
143:"Phillies",144:"Braves",145:"White Sox",146:"Marlins",147:"Yankees",158:"Brewers"};

const NHL_TEAMS={ANA:"Ducks",BOS:"Bruins",BUF:"Sabres",CGY:"Flames",CAR:"Hurricanes",CHI:"Blackhawks",
COL:"Avalanche",CBJ:"Blue Jackets",DAL:"Stars",DET:"Red Wings",EDM:"Oilers",FLA:"Panthers",
LAK:"Kings",MIN:"Wild",MTL:"Canadiens",NSH:"Predators",NJD:"Devils",NYI:"Islanders",
NYR:"Rangers",OTT:"Senators",PHI:"Flyers",PIT:"Penguins",SJS:"Sharks",STL:"Blues",
TBL:"Lightning",TOR:"Maple Leafs",UTA:"Mammoth",VGK:"Golden Knights",WSH:"Capitals",
WPG:"Jets",SEA:"Kraken",VAN:"Canucks"};

const NFL_TEAMS={ARI:"Cardinals",ATL:"Falcons",BAL:"Ravens",BUF:"Bills",CAR:"Panthers",
CHI:"Bears",CIN:"Bengals",CLE:"Browns",DAL:"Cowboys",DEN:"Broncos",DET:"Lions",
GB:"Packers",HOU:"Texans",IND:"Colts",JAX:"Jaguars",KC:"Chiefs",LAC:"Chargers",
LAR:"Rams",LV:"Raiders",MIA:"Dolphins",MIN:"Vikings",NE:"Patriots",NO:"Saints",
NYG:"Giants",NYJ:"Jets",PHI:"Eagles",PIT:"Steelers",SEA:"Seahawks",SF:"49ers",
TB:"Buccaneers",TEN:"Titans",WSH:"Commanders"};

// Abreviations ESPN (celles que renvoie l'API : GS, NY, NO, SA, UTAH, WSH...).
const NBA_TEAMS={ATL:"Hawks",BOS:"Celtics",BKN:"Nets",CHA:"Hornets",CHI:"Bulls",CLE:"Cavaliers",
DAL:"Mavericks",DEN:"Nuggets",DET:"Pistons",GS:"Warriors",HOU:"Rockets",IND:"Pacers",
LAC:"Clippers",LAL:"Lakers",MEM:"Grizzlies",MIA:"Heat",MIL:"Bucks",MIN:"Timberwolves",
NO:"Pelicans",NY:"Knicks",OKC:"Thunder",ORL:"Magic",PHI:"76ers",PHX:"Suns",
POR:"Trail Blazers",SAC:"Kings",SA:"Spurs",TOR:"Raptors",UTAH:"Jazz",WSH:"Wizards"};

const NCAA_CONF=[["BC","CLEM","DUKE","FSU","GT","MIA","NCST","PITT","SMU","STAN","SYR","UVA","VT","WAKE","CAL","LOU","UNC"],["ARIZ","ASU","BAY","BYU","CIN","COLO","HOU","ISU","KU","KSU","OKST","TCU","TTU","UCF","UTAH","WVU"],["ILL","IU","IOWA","MD","MICH","MSU","MINN","NEB","NU","OSU","ORE","PSU","PUR","RUTG","UCLA","USC","WASH","WIS"],["ALA","ARK","AUB","FLA","UGA","UK","LSU","MSST","MIZ","OU","MISS","SC","TENN","TEX","VAN","TA&M"],["BOIS","CSU","FRES","ORST","SDSU","TXST","USU","WSU"]];
const NCAA_TEAMS={"BC":"Boston College","CLEM":"Clemson","DUKE":"Duke","FSU":"Florida State","GT":"Georgia Tech","MIA":"Miami","NCST":"NC State","PITT":"Pittsburgh","SMU":"SMU","STAN":"Stanford","SYR":"Syracuse","UVA":"Virginia","VT":"Virginia Tech","WAKE":"Wake Forest","CAL":"California","LOU":"Louisville","UNC":"North Carolina","ARIZ":"Arizona","ASU":"Arizona State","BAY":"Baylor","BYU":"BYU","CIN":"Cincinnati","COLO":"Colorado","HOU":"Houston","ISU":"Iowa State","KU":"Kansas","KSU":"Kansas State","OKST":"Oklahoma State","TCU":"TCU","TTU":"Texas Tech","UCF":"UCF","UTAH":"Utah","WVU":"West Virginia","ILL":"Illinois","IU":"Indiana","IOWA":"Iowa","MD":"Maryland","MICH":"Michigan","MSU":"Michigan State","MINN":"Minnesota","NEB":"Nebraska","NU":"Northwestern","OSU":"Ohio State","ORE":"Oregon","PSU":"Penn State","PUR":"Purdue","RUTG":"Rutgers","UCLA":"UCLA","USC":"USC","WASH":"Washington","WIS":"Wisconsin","ALA":"Alabama","ARK":"Arkansas","AUB":"Auburn","FLA":"Florida","UGA":"Georgia","UK":"Kentucky","LSU":"LSU","MSST":"Mississippi State","MIZ":"Missouri","OU":"Oklahoma","MISS":"Ole Miss","SC":"South Carolina","TENN":"Tennessee","TEX":"Texas","VAN":"Vanderbilt","TA&M":"Texas A&M","BOIS":"Boise State","CSU":"Colorado State","FRES":"Fresno State","ORST":"Oregon State","SDSU":"San Diego State","TXST":"Texas State","USU":"Utah State","WSU":"Washington State","ND":"Notre Dame"};

// Codes HockeyTech (HomeCode/VisitorCode). SEA = code presume (pas encore vu dans l'API).
const PWHL_TEAMS={BOS:"Boston Fleet",MIN:"Minnesota Frost",MTL:"Montréal Victoire",
NY:"New York Sirens",OTT:"Ottawa Charge",SEA:"Seattle Torrent",TOR:"Toronto Sceptres",
VAN:"Vancouver Goldeneyes",DET:"PWHL Detroit",HAM:"PWHL Hamilton",VGS:"PWHL Las Vegas"};

// Dictionnaire de traduction [FR, EN]
const TR={
  t_lang:["Langue","Language"],
  t_bright:["Luminosité","Brightness"],
  t_screen:["Écran allumé","Screen on"],
  t_wx:["Afficher Horloge et Météo","Show Clock & Weather"],
  t_wxcity:["Ville de la météo","Weather city"],
  t_wildcard:["Classement meilleur 2e","Wild Card Standings"],
  t_wcNhl:["Course aux séries","Playoff Race"],
  t_standNhl:["Afficher classement","Show standings"],
  t_standMlb:["Afficher classement","Show standings"],
  t_standNfl:["Afficher classement","Show standings"],
  t_secNhl:["LNH","NHL"],
  t_secMlb:["MLB","MLB"],
  t_secNfl:["NFL","NFL"],
  t_fav:["Équipe favorite","Favorite team"],
  t_favNhl:["Équipe favorite","Favorite team"],
  t_spMlb:["MLB","MLB"],
  t_spNhl:["LNH","NHL"],
  t_wideNhl:["Affichage avec chronomètre","Clock display"],
  t_secAnim:["Animations et indicateurs","Animations and indicators"],
  t_goalAnim:["Animation de but / touché (favori)","Goal / touchdown animation (favorite)"],
  t_situation:["Indicateurs AN/PP (LNH) et possession (NFL)","PP (NHL) and possession (NFL) indicators"],
  t_testAnim:["Tester l'animation","Test the animation"],
  t_testNhl:["LNH","NHL"],
  t_testNfl:["NFL","NFL"],
  t_rkCfp:["Classement CFP (sinon AP)","CFP ranking (otherwise AP)"],
  t_spNfl:["NFL","NFL"],
  t_liveNfl:["Matchs en direct seulement","Live games only"],
  t_liveNhl:["Matchs en direct seulement","Live games only"],
  t_liveMlb:["Matchs en direct seulement","Live games only"],
  t_favNfl:["Équipe favorite","Favorite team"],
  t_favPwhl:["Équipe favorite","Favorite team"],
  t_livePwhl:["Matchs en direct seulement","Live games only"],
  t_secPwhl:["LPHF","PWHL"],
  t_spPwhl:["LPHF","PWHL"],
  t_navSub:["LNH · MLB · NFL · NBA · NCAA · LPHF","NHL · MLB · NFL · NBA · NCAA · PWHL"],
  t_secNba:["NBA","NBA"],
  t_spNba:["NBA","NBA"],
  t_favNba:["Équipe favorite","Favorite team"],
  t_liveNba:["Matchs en direct seulement","Live games only"],
  t_showStNba:["Afficher classement","Show standings"],
  t_secNcaa:["NCAA Football","NCAA Football"],
  t_spNcaa:["NCAA","NCAA"],
  t_secTop25:["Top 25","Top 25"],
  t_showStNcaaSub:["Afficher le Top 6 dans la rotation","Show the Top 6 in the rotation"],
  t_cfAcc:["ACC","ACC"],t_cfB12:["Big 12","Big 12"],t_cfB10:["Big Ten","Big Ten"],t_cfSec:["SEC","SEC"],t_cfP12:["Pac-12","Pac-12"],
  t_favNc0:["Équipe favorite","Favorite team"],t_favNc1:["Équipe favorite","Favorite team"],t_favNc2:["Équipe favorite","Favorite team"],t_favNc3:["Équipe favorite","Favorite team"],t_favNc4:["Équipe favorite","Favorite team"],t_favNc5:["Équipe favorite","Favorite team"],
  t_liveNcaa:["Matchs en direct seulement","Live games only"],
  t_altLogoNhl:["Logo alternatif","Alternate logo"],
  t_speed:["Vitesse de rotation","Rotation speed"],
  t_ota:["Mise à jour OTA","OTA update"],
  t_reboot:["Redémarrer","Reboot"],
  t_wifi:["Reconfigurer le WiFi","Reconfigure WiFi"],
  t_navSports:["Sports","Sports"],
  t_navWx:["Météo","Weather"],
  t_navWxSub:["Horloge, emplacement","Clock, location"],
  t_navParam:["Paramètres","Settings"],
  t_navParamSub:["Affichage, langue, système","Display, language, system"],
  t_sys:["Système","System"],
  t_ip:["Adresse IP","IP address"],
  t_net:["Réseau","Network"],
  t_fw:["Version","Version"],
  fwCheckBtn:["Vérifier les mises à jour","Check for updates"]
};
const TRX={
  noneFav:["Aucun (rotation complète)","None (full rotation)"],
  sched:["matchs a l'horaire aujourd'hui","games scheduled today"],
  logsShow:["Voir les logs","View logs"],
  logsHide:["Masquer les logs","Hide logs"],
  logsEmpty:["(aucun log pour le moment)","(no logs yet)"],
  rebootQ:["Redémarrer ?","Reboot ?"],
  wifiQ:["Effacer le WiFi enregistré ? L'appareil redémarrera en mode point d'accès.","Erase saved WiFi ? The device will restart in access-point mode."],
  home:["Tableau d'affichage Sports","Sports Scoreboard"],
  sports:["Sports","Sports"],
  meteo:["Météo","Weather"],
  param:["Paramètres","Settings"],
  fwChecking:["vérification…","checking…"],
  fwUpToDate:["à jour","up to date"],
  fwAvail:["nouvelle version","new version"],
  fwInstalling:["installation","installing"],
  fwInstall:["Installer la version","Install version"],
  fwInstallQ:["Installer la version %v ? Le tableau redémarre tout seul à la fin (environ 1 minute). Ne pas le débrancher.","Install version %v ? The board restarts by itself when done (about 1 minute). Do not unplug it."]
};
let lang=0;   // 0=FR, 1=EN
let lastState=null;

// ---- Navigation : accueil + 3 pages, par le #hash (le bouton retour du telephone fonctionne) ----
const VIEWS=['sports','meteo','param'];
function curView(){ const h=location.hash.replace('#',''); return VIEWS.includes(h)?h:''; }
function go(v){ location.hash = v || ''; }
function showView(){
  const v=curView();
  for(const el of document.querySelectorAll('.view')) el.classList.remove('on');
  document.getElementById('v_'+(v||'home')).classList.add('on');
  backBtn.style.display = v ? 'block' : 'none';
  hdr.textContent = TRX[v||'home'][lang];
  window.scrollTo(0,0);
}
window.addEventListener('hashchange',showView);

function applyLang(){
  for(const k in TR) { const el=document.getElementById(k); if(el) el.textContent=TR[k][lang]; }
  langFR.classList.toggle('on', lang==0);
  langEN.classList.toggle('on', lang==1);
  logsBtn.textContent = logsOpen ? TRX.logsHide[lang] : TRX.logsShow[lang];
  hdr.textContent = TRX[curView()||'home'][lang];
  if(lastState) applyDynamic(lastState);   // re-traduit les parties dynamiques
}
function setLang(l){ lang=l; applyLang(); set('lang',l); }

function set(k,v){fetch('/api/set?'+k+'='+v)}
function wxStatusTxt(s){
  const st=s.wxStat|0;
  if(st==1) return lang==0?'Recherche…':'Searching…';
  if(st==2) return lang==0?'Ville introuvable':'City not found';
  if(st==3) return lang==0?'Géolocalisation IP impossible':'IP geolocation failed';
  if(st==4) return lang==0?'Erreur réseau':'Network error';
  if(s.wxPlace) return (s.wxAuto?(lang==0?'Auto (IP) : ':'Auto (IP): '):'')+s.wxPlace;
  return s.wxAuto?(lang==0?'Auto (adresse IP)':'Auto (IP address)'):'';
}
function showWx(s){
  if(typeof s.wxCity==='undefined') return;
  if(document.activeElement!==wxCity) wxCity.value=s.wxCity;
  wxCity.placeholder=lang==0?'Auto (adresse IP)':'Auto (IP address)';
  wxinfo.textContent=wxStatusTxt(s);
}
function setCity(){
  fetch('/api/set?wxCity='+encodeURIComponent(wxCity.value.trim()));
  wxinfo.textContent=lang==0?'Recherche…':'Searching…';
  setTimeout(()=>fetch('/api/state').then(r=>r.json()).then(showWx),4000);
  setTimeout(()=>fetch('/api/state').then(r=>r.json()).then(showWx),10000);
}
function sigTxt(r){
  const q = r>=-55 ? ['excellent','excellent'] : r>=-67 ? ['bon','good'] : r>=-75 ? ['moyen','fair'] : ['faible','weak'];
  return 'WiFi · '+r+' dBm ('+q[lang]+')';
}

// Une liste deroulante n'est reconstruite que si son contenu change : sinon le
// rafraichissement aux 5 s refermait la liste pendant qu'on la consultait.
function fillSel(sel, html){ if(sel.dataset.h!==html){ sel.innerHTML=html; sel.dataset.h=html; } }
function applyDynamic(s){
  let o='<option value="0" '+(s.fav==0?'selected':'')+'>'+TRX.noneFav[lang]+'</option>';
  const sorted=Object.entries(TEAMS).sort((a,b)=>a[1].localeCompare(b[1]));
  for(const [id,name] of sorted)o+=`<option value="${id}" ${id==s.fav?'selected':''}>${name}</option>`;
  fillSel(fav,o);

  const favNhlVal = s.favNhl || "";
  let o2='<option value="" '+(favNhlVal==""?'selected':'')+'>'+TRX.noneFav[lang]+'</option>';
  const sortedNhl=Object.entries(NHL_TEAMS).sort((a,b)=>a[1].localeCompare(b[1]));
  for(const [ab,name] of sortedNhl)o2+=`<option value="${ab}" ${ab==favNhlVal?'selected':''}>${name}</option>`;
  fillSel(favNhl,o2);

  const favNflVal = s.favNfl || "";
  let o3='<option value="" '+(favNflVal==""?'selected':'')+'>'+TRX.noneFav[lang]+'</option>';
  const sortedNfl=Object.entries(NFL_TEAMS).sort((a,b)=>a[1].localeCompare(b[1]));
  for(const [ab,name] of sortedNfl)o3+=`<option value="${ab}" ${ab==favNflVal?'selected':''}>${name}</option>`;
  fillSel(favNfl,o3);

  const favPwhlVal = s.favPwhl || "";
  let o4='<option value="" '+(favPwhlVal==""?'selected':'')+'>'+TRX.noneFav[lang]+'</option>';
  const sortedPwhl=Object.entries(PWHL_TEAMS).sort((a,b)=>a[1].localeCompare(b[1]));
  for(const [ab,name] of sortedPwhl)o4+=`<option value="${ab}" ${ab==favPwhlVal?'selected':''}>${name}</option>`;
  fillSel(favPwhl,o4);

  const favNbaVal = s.favNba || "";
  let o5='<option value="" '+(favNbaVal==""?'selected':'')+'>'+TRX.noneFav[lang]+'</option>';
  const sortedNba=Object.entries(NBA_TEAMS).sort((a,b)=>a[1].localeCompare(b[1]));
  for(const [ab,name] of sortedNba)o5+=`<option value="${ab}" ${ab==favNbaVal?'selected':''}>${name}</option>`;
  fillSel(favNba,o5);

  // Un menu "Équipe favorite" par conference (0-4) + un pour le Top 25 (5, rempli avec le classement courant)
  for(let k=0;k<6;k++){
    const cur=s['favNc'+k]||"";
    let opts='<option value="" '+(cur==""?'selected':'')+'>'+TRX.noneFav[lang]+'</option>';
    let list;
    if(k<5){ list=NCAA_CONF[k].map(ab=>[ab,NCAA_TEAMS[ab]]).sort((a,b)=>a[1].localeCompare(b[1])); }
    else{
      list=(s.top25||[]).map((e,r)=>{const p=e.split('|'); return [p[0],'#'+(r+1)+' '+(p[1]||p[0])];});
      if(cur&&!list.some(x=>x[0]==cur)) list.push([cur,NCAA_TEAMS[cur]||cur]);   // favori sorti du Top 25 : on le garde
      if((s.top25Poll||'')!==(s.rkCfp?'cfp':'ap')&&s.top25Poll!==''&&typeof s.top25Poll!=='undefined') opts+='<option disabled>'+(lang==0?'Mise à jour du classement…':'Updating ranking…')+'</option>';
    }
    for(const [ab,name] of list) opts+=`<option value="${ab}" ${ab==cur?'selected':''}>${name}</option>`;
    fillSel(document.getElementById('favNc'+k),opts);
  }

  document.getElementById('t_spMlb').textContent = 'MLB (' + s.games + ' ' + TRX.sched[lang] + ')';
  document.getElementById('t_spNhl').textContent = TR.t_spNhl[lang] + ' (' + s.gamesNhl + ' ' + TRX.sched[lang] + ')';
  document.getElementById('t_spNfl').textContent = 'NFL (' + s.gamesNfl + ' ' + TRX.sched[lang] + ')';
  if(typeof s.gamesNba!=='undefined') document.getElementById('t_spNba').textContent = 'NBA (' + s.gamesNba + ' ' + TRX.sched[lang] + ')';
  if(typeof s.gamesNcaa!=='undefined') document.getElementById('t_spNcaa').textContent = 'NCAA (' + s.gamesNcaa + ' ' + TRX.sched[lang] + ')';
  if(typeof s.gamesPwhl!=='undefined') document.getElementById('t_spPwhl').textContent = TR.t_spPwhl[lang] + ' (' + s.gamesPwhl + ' ' + TRX.sched[lang] + ')';
  sysIp.textContent = s.ip;
  sysNet.textContent = sigTxt(s.rssi);
  if(typeof s.fw!=='undefined') showFw(s);
}
function load(){fetch('/api/state').then(r=>r.json()).then(s=>{
  lastState=s;
  if(typeof s.lang!=='undefined'){ lang=s.lang; }
  if(document.activeElement!==bright){ bright.value=Math.round(s.bright/255*100);bv.textContent=bright.value+'%'; }
  if(document.activeElement!==speed){ speed.value=s.speed;sv.textContent=s.speed+' s'; }
  document.getElementById('screen').checked=s.screen;wxforce.checked=s.wxforce;
  if(typeof s.wildcard!=='undefined') wildcard.checked=s.wildcard;
  if(typeof s.wcNhl!=='undefined') wcNhl.checked=s.wcNhl;
  spMlb.checked=s.spMlb;spNhl.checked=s.spNhl;altLogoNhl.checked=s.altLogoNhl;
  spNfl.checked=s.spNfl;liveNfl.checked=s.liveNfl;liveNhl.checked=s.liveNhl;wideNhl.checked=!!s.wideNhl;if(typeof s.goalAnim!=='undefined'){goalAnim.checked=s.goalAnim;situation.checked=s.situation;}liveMlb.checked=s.liveMlb;
  showStMlb.checked=s.showStMlb;showStNhl.checked=s.showStNhl;showStNfl.checked=s.showStNfl;
  if(typeof s.spPwhl!=='undefined'){ spPwhl.checked=s.spPwhl; livePwhl.checked=s.livePwhl; }
  if(typeof s.spNba!=='undefined'){ spNba.checked=s.spNba; liveNba.checked=s.liveNba; showStNba.checked=s.showStNba; }
  if(typeof s.spNcaa!=='undefined'){ spNcaa.checked=s.spNcaa; liveNcaa.checked=s.liveNcaa; showStNcaa.checked=s.showStNcaa; rkCfp.checked=!!s.rkCfp; cfAcc.checked=s.cfAcc; cfB12.checked=s.cfB12; cfB10.checked=s.cfB10; cfSec.checked=s.cfSec; cfP12.checked=s.cfP12; }
  applyDynamic(s);
  showWx(s);
  applyLang();
})}
// ---- Mise a jour du firmware depuis GitHub ----
// fwStat : 0 rien, 1 verification, 2 a jour, 3 disponible, 4 installation, 5 erreur
let fwState=null;
function showFw(s){
  fwState=s;
  let t='v'+s.fw;
  if(s.fwStat==1) t+=' · '+TRX.fwChecking[lang];
  else if(s.fwStat==2) t+=' · '+TRX.fwUpToDate[lang];
  else if(s.fwStat==3) t+=' · '+TRX.fwAvail[lang]+' v'+s.fwLatest;
  else if(s.fwStat==4) t+=' · '+TRX.fwInstalling[lang]+' '+s.fwProg+' %';
  if(s.fwErr) t+=' · '+s.fwErr;
  sysFw.textContent=t;
  fwInstBtn.style.display = s.fwStat==3 ? 'inline-block' : 'none';
  fwInstBtn.textContent = TRX.fwInstall[lang]+' v'+s.fwLatest;
  fwCheckBtn.disabled = (s.fwStat==1 || s.fwStat==4);
}
function fwDo(d){ fetch('/api/fw?do='+d).then(()=>{ setTimeout(load,1500); setTimeout(load,6000); }); }
function fwInstall(){
  if(!fwState||!confirm(TRX.fwInstallQ[lang].replace('%v','v'+fwState.fwLatest))) return;
  fwDo('install');
  const t=setInterval(()=>load(),2000);       // progression ; le tableau redemarre a la fin
  setTimeout(()=>clearInterval(t),180000);
}
function rebootConfirm(){ if(confirm(TRX.rebootQ[lang])) fetch('/api/reboot'); }
function wifiConfirm(){ if(confirm(TRX.wifiQ[lang])) fetch('/api/wifi_reset'); }

let logsOpen=false, logsTimer=null;
function refreshLogs(){
  fetch('/api/logs').then(r=>r.text()).then(t=>{
    const box=document.getElementById('logsBox');
    const atBottom = box.scrollTop + box.clientHeight >= box.scrollHeight - 10;
    box.textContent = t || TRX.logsEmpty[lang];
    if(atBottom) box.scrollTop = box.scrollHeight;
  });
}
function toggleLogs(){
  logsOpen=!logsOpen;
  const box=document.getElementById('logsBox');
  box.style.display = logsOpen ? 'block' : 'none';
  logsBtn.textContent = logsOpen ? TRX.logsHide[lang] : TRX.logsShow[lang];
  if(logsOpen){ refreshLogs(); box.scrollTop=box.scrollHeight; logsTimer=setInterval(refreshLogs,2000); }
  else if(logsTimer){ clearInterval(logsTimer); logsTimer=null; }
}
showView();
load();setInterval(load,5000);
</script></body></html>
)HTML";

// ====================== PAGE DU PORTAIL DE CONFIG WIFI ======================
const char PORTAL_HTML[] PROGMEM = R"HTML(
<!DOCTYPE html><html lang="fr"><head><meta charset="utf-8">
<meta name="viewport" content="width=device-width,initial-scale=1">
<title>Configuration WiFi</title>
<style>
*{box-sizing:border-box;font-family:system-ui,sans-serif}
body{margin:0;background:#121212;color:#e8e8e8;padding:16px;max-width:480px;margin:auto}
h1{font-size:20px;font-weight:500}
small{color:#9a9a9a}
.net{background:#1e1e1e;border-radius:8px;padding:12px;margin:6px 0;cursor:pointer;
     display:flex;justify-content:space-between;align-items:center}
.net:active{background:#2a2a2a}
input,button{width:100%;font-size:15px;padding:11px;border-radius:8px;border:none;
             margin:6px 0;box-sizing:border-box}
input{background:#2a2a2a;color:#fff}
button{background:#1d6fbc;color:#fff;font-weight:500;cursor:pointer}
button.sec{background:#2a2a2a}
</style></head><body>
<h1>Configuration WiFi</h1>
<p><small>Choisis ton reseau, entre le mot de passe, puis enregistre. Le tableau
redemarrera connecte.</small></p>
<button class="sec" onclick="scan()">Rafraichir la liste</button>
<div id="nets"><small>Recherche des reseaux...</small></div>
<input id="ssid" placeholder="Nom du reseau (SSID)">
<input id="pass" type="password" placeholder="Mot de passe">
<button onclick="save()">Enregistrer et connecter</button>
<script>
function pick(s){document.getElementById('ssid').value=s;document.getElementById('pass').focus()}
function scan(){
  document.getElementById('nets').innerHTML='<small>Recherche...</small>';
  fetch('/scan').then(r=>r.json()).then(l=>{
    l.sort((a,b)=>b.rssi-a.rssi);
    let h='';
    for(const n of l){
      const nm=(n.ssid||'(cache)');
      const lock=n.enc?'&#128274;':'';
      h+=`<div class="net" onclick="pick(${JSON.stringify(nm)})">`+
         `<span>${nm}</span><span><small>${lock} ${n.rssi} dBm</small></span></div>`;
    }
    document.getElementById('nets').innerHTML=h||'<small>Aucun reseau trouve</small>';
  }).catch(()=>{document.getElementById('nets').innerHTML='<small>Erreur de scan</small>'});
}
function save(){
  const s=document.getElementById('ssid').value, p=document.getElementById('pass').value;
  if(!s){alert('Choisis ou entre un reseau');return}
  fetch('/save?ssid='+encodeURIComponent(s)+'&pass='+encodeURIComponent(p))
    .then(r=>r.text()).then(t=>{document.body.innerHTML='<h1>Enregistre</h1><p>'+t+'</p>';});
}
scan();
</script></body></html>
)HTML";
